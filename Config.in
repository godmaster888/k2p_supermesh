## Config.in
```kconfig
#

mainmenu "Buildroot2 Configuration"

config BR2_HAVE_DOT_CONFIG
	bool
	default y

config BR2_VERSION
	string
	option env="BR2_VERSION_FULL"

source "vendor/Config.in"
source "board/Config.in"
source "target/Config.in"
#source "target/Config.in.arch"


menu "Build options"

config BR2_PROFILE_CFLAGS
	string "Extra CFLAGS"

menu "Commands"

config BR2_WGET
	string "Wget command"
	default "wget --passive-ftp -nd -t 3"

config BR2_SVN
	string "Subversion (svn) command"
	default "svn"

config BR2_BZR
	string "Bazaar (bzr) command"
	default "bzr"

config BR2_GIT
	string "Git command"
	default "git"

config BR2_ZCAT
	string "zcat command"
	default "gzip -d -c"
	help
	  Command to be used to extract a gzip'ed file to stdout. zcat
	  is identical to gunzip -c except that the former may not be
	  available on your system.
	  Default is "gzip -d -c"
	  Other possible values include "gunzip -c" or "zcat".

config BR2_BZCAT
	string "bzcat command"
	default "bzcat"
	help
	  Command to be used to extract a bzip2'ed file to stdout.
	  bzcat is identical to bunzip2 -c except that the former may
	  not be available on your system.
	  Default is "bzcat"
	  Other possible values include "bunzip2 -c" or "bzip2 -d -c".

config BR2_XZCAT
	string "xzcat command"
	default "xzcat"
	help
	  Command to be used to extract a xz'ed file to stdout.
	  Default is "xzcat"

config BR2_LZCAT
	string "lzcat command"
	default "lzip -d -c"
	help
	  Command to be used to extract a lzip'ed file to stdout.
	  Default is "lzip -d -c"

config BR2_TAR_OPTIONS
	string "Tar options"
	default ""
	help
	  Options to pass to tar when extracting the sources.
	  E.g. " -v --exclude='*.svn*'" to exclude all .svn internal files
	  and to be verbose.
endmenu

config BR2_DL_DIR
	string "Download dir"
	default "$(TOPDIR)/dl"
	help
	  Directory to store all the source files that we need to fetch.
	  If the Linux shell environment has defined the BUILDROOT_DL_DIR
	  environment variable, then this overrides this configuration item.

	  The default is $(TOPDIR)/dl

#source	"target/device/Config.in.mirrors"

config BR2_JLEVEL
	int "Number of jobs to run simultaneously"
	default "2"
	help
	  Number of jobs to run simultaneously

config BR2_DEPRECATED
	bool "Show packages that are deprecated or obsolete"
	help
	  This option hides outdated/obsolete versions of packages.

config BR2_ENABLE_DEBUG
	bool "build packages with debugging symbols"
	help
	  Build packages with debugging symbols enabled. All libraries
	  and binaries in the 'staging' directory will have debugging
	  symbols, which allows remote debugging even if libraries and
	  binaries are stripped on the target. Whether libraries and
	  binaries are stripped on the target is controlled by the
	  BR2_STRIP_* options below.

config BR2_STRIP_EXCLUDE_FILES
	string "executables that should not be stripped"
	default ""
	depends on BR2_STRIP_strip
	help
	  You may specify a space-separated list of binaries and
	  libraries here that should not be stripped on the target.

config BR2_STRIP_EXCLUDE_DIRS
	string "directories that should be skipped when stripping"
	default ""
	depends on BR2_STRIP_strip
	help
	  You may specify a space-separated list of directories that
	  should be skipped when stripping. Binaries and libraries in
	  these directories will not be touched. The directories should
	  be specified relative to the target directory, without leading
	  slash.

if BR2_ENABLE_DEBUG
choice
	prompt "gcc debug level"
	default BR2_DEBUG_3
	help
	  Set the debug level for gcc

config BR2_DEBUG_1
	bool "debug level 1"
	help
	  Debug level 1 produces minimal information, enough
	  for making backtraces in parts of the program that
	  you don't plan to debug. This includes descriptions
	  of functions and external variables, but no information
	  about local variables and no line numbers.

config BR2_DEBUG_2
	bool "debug level 2"
	help
	  The default gcc debug level is 2

config BR2_DEBUG_3
	bool "debug level 3"
	help
	  Level 3 includes extra information, such as all the
	  macro definitions present in the program. Some debuggers
	  support macro expansion when you use -g3.
endchoice
endif

config BR2_STRIP_strip
	bool "strip target binaries"
	depends on !BR2_ELF2FLT
	default y
	help
	  Binaries and libraries in the target filesystem will be
	  stripped using the normal 'strip' command. This allows to
	  save space, mainly by removing debugging symbols. Debugging
	  symbols on the target are needed for native debugging, but
	  not when remote debugging is used.

choice
	prompt "gcc optimization level"
	default BR2_OPTIMIZE_S
	help
	  Set the optimization level for gcc

config BR2_OPTIMIZE_0
	bool "optimization level 0"
	help
	  Do not optimize. This is the default.

config BR2_OPTIMIZE_1
	bool "optimization level 1"
	help
	  Optimize. Optimizing compilation takes somewhat more time,
	  and a lot more memory for a large function. With -O, the
	  compiler tries to reduce code size and execution time,
	  without performing any optimizations that take a great deal
	  of compilation time. -O turns on the following optimization
	  flags: -fdefer-pop -fdelayed-branch -fguess-branch-probability
	  -fcprop-registers -floop-optimize -fif-conversion
	  -fif-conversion2 -ftree-ccp -ftree-dce -ftree-dominator-opts
	  -ftree-dse -ftree-ter -ftree-lrs -ftree-sra -ftree-copyrename
	  -ftree-fre -ftree-ch -funit-at-a-time -fmerge-constants
	  -O also turns on -fomit-frame-pointer on machines where doing
	  so does not interfere with debugging.

config BR2_OPTIMIZE_2
	bool "optimization level 2"
	help
	  Optimize even more. GCC performs nearly all supported optimizations
	  that do not involve a space-speed tradeoff. The compiler does not
	  perform loop unrolling or function inlining when you specify -O2.
	  As compared to -O, this option increases both compilation time and
	  the performance of the generated code. -O2 turns on all optimization
	  flags specified by -O. It also turns on the following optimization
	  flags: -fthread-jumps -fcrossjumping -foptimize-sibling-calls
	  -fcse-follow-jumps -fcse-skip-blocks -fgcse  -fgcse-lm
	  -fexpensive-optimizations -fstrength-reduce -frerun-cse-after-loop
	  -frerun-loop-opt -fcaller-saves -fpeephole2 -fschedule-insns
	  -fschedule-insns2 -fsched-interblock -fsched-spec -fregmove
	  -fstrict-aliasing -fdelete-null-pointer-checks -freorder-blocks
	  -freorder-functions -falign-functions -falign-jumps -falign-loops
	  -falign-labels -ftree-vrp -ftree-pre
	  Please note the warning under -fgcse about invoking -O2 on programs
	  that use computed gotos.

config BR2_OPTIMIZE_3
	bool "optimization level 3"
	help
	  Optimize yet more. -O3 turns on all optimizations specified by -O2
	  and also turns on the -finline-functions, -funswitch-loops and
	  -fgcse-after-reload options.

config BR2_OPTIMIZE_S
	bool "optimize for size"
	help
	  Optimize for size. -Os enables all -O2 optimizations that do not
	  typically increase code size. It also performs further optimizations
	  designed to reduce code size. -Os disables the following optimization
	  flags: -falign-functions -falign-jumps -falign-loops -falign-labels
	  -freorder-blocks -freorder-blocks-and-partition -fprefetch-loop-arrays
	  -ftree-vect-loop-version

endchoice

choice
	bool "libraries"
	default BR2_SHARED_LIBS
	help
	  Select the type of libraries you want to use on the target.

	  The default is to build dynamic libraries and use those on the
	  target filesystem, except when the architecture and/or the
	  selected binary format does not support shared libraries.

config BR2_STATIC_LIBS
	bool "static only"
	help
	  Build and use only static libraries. No shared libraries will
	  be installed on the target. This potentially increases your
	  code size and should only be used if you know what you are
	  doing. Note that some packages may not be available when this
	  option is enabled, due to their need for dynamic library
	  support.

config BR2_SHARED_LIBS
	bool "shared only"
	help
	  Build and use only shared libraries. This is the recommended
	  solution as it saves space and build time.

config BR2_SHARED_STATIC_LIBS
	bool "both static and shared"
	help
	  Build both shared and static libraries, but link executables
	  dynamically. While building both shared and static libraries
	  take more time and more disk space, having static libraries
	  may be useful to link some of the applications statically.

endchoice

config BR2_GLOBAL_PATCH_DIR
	string "global patch directories"
	help
	  You may specify a space separated list of one or more
	  directories containing global package patches. For a specific
	  version <packageversion> of a specific package <packagename>,
	  patches are applied as follows:

	  First, the default Buildroot patch set for the package is
	  applied from the package's directory in Buildroot.

	  Then for every directory - <global-patch-dir> - that exists in
	  BR2_GLOBAL_PATCH_DIR, if the directory
	  <global-patch-dir>/<packagename>/<packageversion>/ exists,
	  then all *.patch files in this directory will be applied.

	  Otherwise, if the directory <global-patch-dir>/<packagename>
	  exists, then all *.patch files in the directory will be
	  applied.

config BR2_HAVE_DOCUMENTATION
	bool "documentation on the target"
	help
	  Install the documentation, including manual pages and info
	  pages, on the target.
	  If you say n here, your target will not contain any
	  documentation.

config BR2_HAVE_DEVFILES
	bool "development files in target filesystem"
	help
	  Install headers and static libraries in the
	  target filesystem

if BR2_rlx
config BR2_RLX_NOT_CASTRATE
	bool "Do not castrate libs"
	default n
endif

config BR2_BUILD_STATS
	bool "Collect statistics for installed packages"
	default n
	help
	  You can visualize collected data.
	  See make graph-build, make graph-size.

config BR2_BUILD_GPL
	bool "GPL-specific build"
	default n
	help
	  Features:
	  1. Build host-cmake even if it is already installed on the build host.

config BR2_DOWNLOAD_ALLOW_EXTERNAL_SITES
	bool "Allow package download from external sites (FOR DEVELOP BUILDS ONLY)"
	help
		Disable the sanity check of $(PKG)_SITE for external sites.
		Use it only for debug new packages!

config BR2_KERNEL_MIRROR
	string "Kernel.org mirror"
	default "http://www.kernel.org/pub/"
	help
	  kernel.org is mirrored on a number of servers around the world.
	  The following allows you to select your preferred mirror.

	  Have a look on the kernel.org site for a list of mirrors, then enter
	  the URL to the base directory.  Examples:

	     http://www.XX.kernel.org/pub (XX = country code)
	     http://mirror.aarnet.edu.au/pub/ftp.kernel.org

config BR2_GNU_MIRROR
	string "GNU Software mirror"
	default "http://ftp.gnu.org/pub/gnu"
	help
	  GNU has multiple software mirrors scattered around the world.
	  The following allows you to select your preferred mirror.

	  Have a look on the gnu.org site for a list of mirrors, then enter
	  the URL to the base directory.  Examples:

	     http://ftp.gnu.org/pub/gnu
	     http://mirror.aarnet.edu.au/pub/gnu

config BR2_DEBIAN_MIRROR
	string "Debian Software mirror"
	default "http://ftp.debian.org"
	help
	  Debian has multiple software mirrors scattered around the world.
	  The following allows you to select your preferred mirror.

	  Usually, just add your country code like XX here:
	  http://ftp.XX.debian.org

endmenu

source "toolchain/Config.in"
source "package/Config.in"
source "system/Config.in"
source "fs/Config.in"
source "boot/Config.in"
source "linux/Config.in"
source "Config.in.legacy"
```

## board/Config.in
```kconfig
menu "Board options"

menu "Config settings"

config BR2_DLINK_CONFIG_SHARED_MEMORY_SIZE
	int "Size in bytes for shared memory storage"
	default 262144

config BR2_DLINK_CONFIG_FLASH_SIZE
	int "Size in bytes for flash storage"
	default 61440 if BR2_ralink
	default 1048576 if (BR2_i386 || BR2_x86_64)
	default 65536 if BR2_qca
	default 65536 if BR2_rlx

	default 65536

endmenu

config BR2_modems
	bool "DSL Modem support"

config BR2_NAND
	bool "NAND flash support"
	default n

config BR2_NAND_BLOCK_SIZE
	string "NAND block size"
	default "128"
	depends on BR2_NAND

config BR2_PSK_ON_FLASH
	bool "Storage base WPA PSK on flash"
	depends on BR2_SUPPORT_WIFI

config BR2_SSID_ON_FLASH
	bool "Storage base SSID on flash"
	depends on BR2_SUPPORT_WIFI

config BR2_FIBER
	bool "FIBER WAN support"
	default n

config BR2_GPON
	bool "Support GPON WAN"
	default n
	depends on BR2_rlx_9607

config BR2_SUPPORT_ETHERWAN
	bool "Support ETHERWAN"
	default n
	depends on BR2_modems || BR2_rlx_9607
	help
	  Converting LAN to WAN port (ethernet)

config BR2_SUPPORT_GIGABIT_ETHERNET
	bool "Support gigabit ethernet"
	default n

config BR2_SUPPORT_ADSL
	bool "Support ADSL"
	default y
	depends on BR2_modems

config BR2_SUPPORT_VDSL
	bool "Support VDSL"
	default n
	depends on BR2_modems

config BR2_SUPPORT_VDSL_PROFILE_35B
	bool "Support VDSL profile 35B"
	default n
	depends on BR2_SUPPORT_VDSL

config BR2_SUPPORT_ADSL_GINP
	bool "Support VDSL/ADSL G.inp"
	default n
	depends on BR2_modems && (BR2_SUPPORT_VDSL || BR2_SUPPORT_ADSL)

config BR2_SUPPORT_VDSL_GVECTOR
	bool "Support VDSL G.vector"
	default n
	depends on BR2_modems && BR2_SUPPORT_VDSL

source board/Config.wifi.in

menu "USB"
choice
	prompt "Embedded modem"
	default BR2_EMBEDDED_MODEM_NO
	help
	  Select the embedded modem type

config BR2_EMBEDDED_MODEM_NO
	bool "None"

config BR2_EMBEDDED_MODEM_3G
	bool "3G"

config BR2_EMBEDDED_MODEM_LTE
	bool "LTE"
endchoice

config BR2_SUPPORT_EMBEDDED_MODEM_PM
	bool "Support modem PM"
	depends on BR2_EMBEDDED_MODEM_LTE
	help
		Select embedded modem power management
endmenu

menu "WAN/LAN Configuration"
config BR2_ARCH_BASE_INTERFACE
	string "Name for interface WAN (WAN_IFNAME)"
	default "eth2"
config SWITCH_WAN_PHY
	int "Index WAN port in switch table (WAN_PHY)"
	default 4
config SWITCH_COUNT_PHY_PORTS
	int "Count physical ports (COUNT_PHY_PORTS)"
	default 5
menu "Partition WAN/LAN"
config BR2_SUPPORT_REMAPPING_WAN
	bool "WAN port reassignment support."
	default y if BR2_ralink
	default y if BR2_qca
	default y if BR2_i386
	default y if BR2_x86_64
	default y if RLX_86XX

config BR2_SUPPORT_MULTI_WAN
	bool "WAN port reassignment support."
	default y if BR2_ralink
	default y if BR2_qca
	default y if BR2_i386
	default y if BR2_x86_64
endmenu


config BR2_TARGET_MAC_COUNT
	int "Count of alloted MAC-addresses per device"
	default 8 if BR2_SUPPORT_WIFI_5GHZ
	default 4

endmenu

config BR2_SUPPORT_VLAN_PRIORITY
	bool "Support vlan priority 802.1p"
	default n

config BR2_SUPPORT_VLAN_TRUNKING
	bool "Vlan trunk support"

config BR2_DLINK_ALLOW_DUPLICATE_VID
	bool "Allow duplicate vlan id"

config BR2_CHECK_FLASH_SIZE
	bool "Check flash size"
	help
		Для того, чтобы добавить поддержку своей архитектуры требуется
		- заполнить BR2_FLASH_SIZE - размер флешки в целом
		- добавить дефайн GET_FW_OFFSET в своём target/pack.mk, который будет выдавать смещение на флешке, по которому будет записываться прошивка
		- включить BR2_CHECK_FLASH_SIZE

config BR2_FLASH_SIZE
	int "Flash size (Bytes)"
	depends on BR2_CHECK_FLASH_SIZE
	default 4194304
	range 1048576 134217728
	help
		Flash size in Mbytes.

config BR2_SUPPORT_VIRTUAL_COM
	bool "Virtual COM"
	default n

endmenu
```
