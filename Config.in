## boot/Config.in
```kconfig
menu "Bootloaders"

config BR2_BOOTLOADER_EXTERNAL_LOCATION
	string "URL to bootloader repository"
	default "sdk_boot/rtl/bootcode_rtl8197f" if RTL8197F

config BR2_BOOTLOADER_EXTERNAL_BRANCH
	string "Branch of bootloader repository"
	depends on BR2_BOOTLOADER_EXTERNAL_LOCATION != ""

config BR2_BOOTLOADER_CONFIG_COMMANDS
	string "bootloader's config commands"

config BR2_BOOTLOADER_INSTALL_FILE
	string "bootloader's install file"

config BR2_BOOTLOADER_UPDATE_FROM_FW
	bool "update bootloader from fw at boot"

config BR2_BOOTLOADER_HTTP_SERVER
	bool "http server for crash mode"
	depends on RTL9607C

config BR2_BOOTLOADER_HTTP_IP_ADDR
	depends on BR2_BOOTLOADER_HTTP_SERVER
	string "ip address for http server in crash mode"
	default "192.168.0.1"

config BR2_DUAL_BOOT_FW
	bool "make fw for dual boot"

config BR2_BOOTLOADER_UPDATE_RAW_OOB
	bool "update bootloader using write in raw mode with oob"
	default n
	depends on BR2_NAND && BR2_PACKAGE_LIBMTD

config BR2_BOOTLOADER_SIGN_FW_CHECK
	bool "check fw sign in bootloader"
	depends on BR2_ralink
	default n

config BR2_BOOTLOADER_CONFIG_FILE
	string "bootloader configuration file name"
	depends on BR2_ralink

endmenu
```

## fs/Config.in
```kconfig
menu "Target filesystem options"

choice
	prompt "Root FS skeleton"

config BR2_ROOTFS_SKELETON_DEFAULT
	bool "default target skeleton"
	help
	  Use default target skeleton

config BR2_ROOTFS_SKELETON_CUSTOM
	bool "custom target skeleton"
	help
	  Use custom target skeleton.

endchoice

if BR2_ROOTFS_SKELETON_CUSTOM
config BR2_ROOTFS_SKELETON_CUSTOM_PATH
	string "custom target skeleton path"
	default "fs/skeleton"
	help
	  Path custom target skeleton.
endif

source "fs/cramfs/Config.in"
source "fs/cloop/Config.in"
source "fs/ext2/Config.in"
source "fs/jffs2/Config.in"
source "fs/ubifs/Config.in"
source "fs/squashfs/Config.in"
source "fs/tar/Config.in"
source "fs/cpio/Config.in"
source "fs/iso9660/Config.in"
source "fs/initramfs/Config.in"
source "fs/romfs/Config.in"

config BR2_USE_JFFS2_PARTITION_512K
	bool "Use additional jffs2 partition"
	help
	  Use additional jffs2 partition (name = "JFFS2" size = 512K)

endmenu
```

## fs/squashfs/Config.in
```kconfig
config BR2_TARGET_ROOTFS_SQUASHFS
	bool "squashfs root filesystem"
	help
	  Build a squashfs root filesystem

if BR2_TARGET_ROOTFS_SQUASHFS
choice
	prompt "SquashFS version"
	default BR2_TARGET_ROOTFS_SQUASHFS4
	help
	  Select the Squash filesystem version to use to generate the
	  root filesystem.

config BR2_TARGET_ROOTFS_SQUASHFS4
       bool "4.x"

config BR2_TARGET_ROOTFS_SQUASHFS3
       bool "3.x"

endchoice

choice
	prompt "Compression algorithm"
	default BR2_TARGET_ROOTFS_SQUASHFS4_GZIP
	depends on BR2_TARGET_ROOTFS_SQUASHFS4
	help
	  Select the squashfs compression algorithm to use when
	  generating the filesystem.

config BR2_TARGET_ROOTFS_SQUASHFS4_GZIP
       bool "gzip"

config BR2_TARGET_ROOTFS_SQUASHFS4_LZMA
       bool "lzma"

config BR2_TARGET_ROOTFS_SQUASHFS4_LZO
       bool "lzo"

config BR2_TARGET_ROOTFS_SQUASHFS4_XZ
       bool "xz"

endchoice


choice
	prompt "Compression blocksize"
	default BR2_TARGET_ROOTFS_SQUASHFS_BS_64K  if BR2_TARGET_ROOTFS_SQUASHFS3
	default BR2_TARGET_ROOTFS_SQUASHFS_BS_256K if BR2_ralink
	default BR2_TARGET_ROOTFS_SQUASHFS_BS_128K
	help
	  Greater value => better compression but increases mem usage while working
	  You can decrease SQUASHFS_FRAGMENT_CACHE_SIZE to free memory.

config BR2_TARGET_ROOTFS_SQUASHFS_BS_64K
	bool "64k"
config BR2_TARGET_ROOTFS_SQUASHFS_BS_128K
	bool "128k"
config BR2_TARGET_ROOTFS_SQUASHFS_BS_256K
	bool "256k"
config BR2_TARGET_ROOTFS_SQUASHFS_BS_512K
	bool "512k"
config BR2_TARGET_ROOTFS_SQUASHFS_BS_1024K
	bool "1024k"

endchoice

config BR2_TARGET_ROOTFS_SQUASHFS_BS
	string
	default "64k"   if BR2_TARGET_ROOTFS_SQUASHFS_BS_64K
	default "128k"  if BR2_TARGET_ROOTFS_SQUASHFS_BS_128K
	default "256k"  if BR2_TARGET_ROOTFS_SQUASHFS_BS_256K
	default "512k"  if BR2_TARGET_ROOTFS_SQUASHFS_BS_512K
	default "1024k" if BR2_TARGET_ROOTFS_SQUASHFS_BS_1024K

endif
```

## linux/Config.in
```kconfig
menu "Kernel"

config BR2_LINUX_KERNEL
	bool "Linux Kernel"
	help
	  Enable this option if you want to build a Linux kernel for
	  your embedded device

if BR2_LINUX_KERNEL

config BR2_LINUX_KERNEL_CUSTOM_REPO
	string "Git repository"

config BR2_LINUX_KERNEL_CUSTOM_BRANCH
	string "Git branch (empty if default branch)"
	default "master"

config BR2_LINUX_KERNEL_3_10
	bool "Kernel version 3.10+"
	default n
	help
	  Enable this option if you have Linux kernel version 3.10 or greater.

#
# Configuration selection
#

config BR2_LINUX_KERNEL_USE_CUSTOM_CONFIG
	# bool "Using a custom config file"
	bool
	default y

config BR2_LINUX_KERNEL_CUSTOM_CONFIG_FILE
	string "Configuration file path"
	depends on BR2_LINUX_KERNEL_USE_CUSTOM_CONFIG
	help
	  Path to the kernel configuration file

choice
	prompt "Kernel modules install mode"
	default BR2_LINUX_KERNEL_MODULES_FLAT

config BR2_LINUX_KERNEL_MODULES_TREE
	bool "Modules tree in /lib/modules/$(uname -r)"

config BR2_LINUX_KERNEL_MODULES_FLAT
	bool "Modules (flat) in /lib/modules/"

endchoice

#
# Binary format
#

choice
	prompt "Kernel binary format"

config BR2_LINUX_KERNEL_UIMAGE
	bool "uImage"

config BR2_LINUX_KERNEL_BZIMAGE
	bool "bzImage"

config BR2_LINUX_KERNEL_ZIMAGE
	bool "zImage"

config BR2_LINUX_KERNEL_VMLINUX_BIN
	bool "vmlinux.bin"

config BR2_LINUX_KERNEL_LZIMAGE
	bool "lzmaImage"

config BR2_LINUX_KERNEL_VMLINUX
	bool "vmlinux"

endchoice

config BR2_LINUX_KERNEL_WAR_UIMAGE
	bool "Create uImage from vmlinux.bin"
	default n if BR2_rtk_ms
	default y
	depends on BR2_LINUX_KERNEL_VMLINUX_BIN

#
# Debug
#

config BR2_LINUX_KERNEL_INSTALL_SYSTEM_MAP
	bool "Install System.map into fw"
	default n
	help
	  Places generated System.map to root
	  of rootfs. For debug purposes (kernel profiling tools).

endif # BR2_LINUX_KERNEL

#
# Arch-specific
#

if RLX_819X
source "linux/rlx_819x/Config.in"
endif

if RLX_86XX
source "linux/rlx_86xx/Config.in"
endif

endmenu
```

## linux/rlx_819x/Config.in
```kconfig
choice
	prompt "Realtek SDK version"
	default BR2_RTK_SDK_RETAIL

	config BR2_RTK_SDK_RETAIL
		bool "SDK 3.4.11/3.4.14"

	config BR2_RTK_SDK_TELECOM
		bool "SDK 3.4T"
		depends on RTL8197F

endchoice

choice
	prompt "Kernel WiFi driver"
	depends on BR2_SUPPORT_WIFI && BR2_RTK_SDK_RETAIL
	default BR2_RTL8192CD_VER_3414B

	config BR2_RTL8192CD_VER_3414B
		bool "3.4.14B"
		depends on RTL8197F

endchoice
```

## linux/rlx_86xx/Config.in
```kconfig
choice
	prompt "Kernel WiFi driver"
	depends on BR2_SUPPORT_WIFI
	default BR2_RTL8192CD_VER_406

	config BR2_RTL8192CD_VER_405
		bool "4.0.5"
		depends on RTL8685PB

	config BR2_RTL8192CD_VER_406
		bool "4.0.6"
		depends on RTL8685PB || RTL8685FB

endchoice
```

## output/build/kernel/drivers/net/wireless/mtk/Kconfig
```kconfig
menuconfig WIFI_MT7603E
    bool "MT7603E WiFi"
    default n
if WIFI_MT7603E
    source "drivers/net/wireless/mtk/mt7603e/mt7603_wifi/Kconfig"
endif

menuconfig WIFI_MT7610E
    bool "MT7610E WiFi"
    default n
if WIFI_MT7610E
    source "drivers/net/wireless/mtk/mt7610e/mt7610_wifi/Kconfig"
endif

menuconfig WIFI_MT7615E
    bool "MT7615E WiFi"
    default n
if WIFI_MT7615E
    source "drivers/net/wireless/mtk/mt7615e/mt_wifi/embedded/Kconfig"
endif

menuconfig WIFI_MT7663E
    bool "MT7663E WiFi"
    default n
if WIFI_MT7663E
    source "drivers/net/wireless/mtk/mt7663e/mt_wifi/embedded/Kconfig"
endif

menuconfig WIFI_MT7620
    bool "MT7620 WiFi"
    default n
if WIFI_MT7620
    source "drivers/net/wireless/mtk/mt7620/mt7620_wifi_ap/Kconfig"
endif

menuconfig WIFI_MT7628
    bool "MT7628 WiFi"
    default n
if WIFI_MT7628
    source "drivers/net/wireless/mtk/mt7628/mt7628_wifi/embedded/Kconfig"
endif

menuconfig WIFI_MT76X2E
    bool "MT76X2E WiFi"
    default n
if WIFI_MT76X2E
    source "drivers/net/wireless/mtk/mt76x2e/mt76x2_wifi/Kconfig"
endif
```
