## package/Config.in
```kconfig
menu "Package Selection for the target"

source "package/private/Config.in"

menu "WAN Connections"
source "package/pppd/Config.in"
source "package/xl2tp/Config.in"
source "package/pptpclient/Config.in"
source "package/poptop/Config.in"
source "package/udhcp/Config.in"
source "package/wpa_supplicant/Config.in"
source "package/lanauth/Config.in"
endmenu

# Большие группы
source "package/Config_WIFI.in"
source "package/Config_USB.in"
source "package/Config_IPv6.in"

source "package/busybox/Config.in"

menu "Libraries"
menu "Compressors and decompressors"
if BR2_PACKAGE_BUSYBOX_SHOW_OTHERS
source "package/bzip2/Config.in"
source "package/gzip/Config.in"
endif
source "package/lzop/Config.in"
source "package/lzma/Config.in"
source "package/xz/Config.in"
source "package/minilzo/Config.in"
source "package/lzo/Config.in"
source "package/zlib/Config.in"
endmenu

menu "Crypto"
source "package/axtls/Config.in"
source "package/bearssl/Config.in"
source "package/ca-certificates/Config.in"
source "package/libmd5-rfc/Config.in"
source "package/libtomcrypt/Config.in"
source "package/openssl/Config.in"
endmenu

menu "Database"
source "package/sqlite/Config.in"
endmenu

menu "Filesystem"
source "package/libconfuse/Config.in"
endmenu

menu "JSON/XML"
source "package/expat/Config.in"
source "package/libroxml/Config.in"
source "package/jansson/Config.in"
source "package/libjsonc/Config.in"
source "package/cereal/Config.in"

endmenu


menu "Networking"
source "package/libmnl/Config.in"
source "package/libnetfilter_queue/Config.in"
source "package/libnfnetlink/Config.in"
source "package/libnl/Config.in"
source "package/libnl-tiny/Config.in"
source "package/libpcap/Config.in"
source "package/libumqtt/Config.in"
source "package/openzwave/Config.in"
source "package/nat_rtsp_module/Config.in"
endmenu

menu "Other"
source "package/boost/Config.in"
source "package/gengetopt/Config.in"
source "package/libbsd/Config.in"
source "package/libcap/Config.in"
source "package/libcrc/Config.in"
source "package/libev/Config.in"
source "package/libevent/Config.in"
source "package/libexif/Config.in"
source "package/libflac/Config.in"
source "package/libid3tag/Config.in"
source "package/libite/Config.in"
source "package/libjpeg/Config.in"
source "package/libogg/Config.in"
source "package/libvorbis/Config.in"
source "package/libstrophe/Config.in"
source "package/libtommath/Config.in"
source "package/lua-minify/Config.in"
source "package/tz/Config.in"
source "package/util-linux/Config.in"
endmenu
endmenu

menu "Miscellaneous"
source "package/domoticz/Config.in"
source "package/libctelebot/Config.in"
endmenu

menu "Networking applications"
source "package/arptables/Config.in"
source "package/coovachilli/Config.in"
source "package/dnsmasq/Config.in"
source "package/dropbear/Config.in"
source "package/ebtables/Config.in"
source "package/inadyn/Config.in"
source "package/iperf3/Config.in"
source "package/iproute2/Config.in"
source "package/ipsec-tools/Config.in"
source "package/iptables/Config.in"
source "package/libcurl/Config.in"
source "package/mdnsresponder/Config.in"
source "package/mini_upnp_rlt/Config.in"
source "package/miniupnpd/Config.in"
source "package/mosquitto/Config.in"
source "package/net-snmp/Config.in"
source "package/openvpn/Config.in"
source "package/p0f/Config.in"
source "package/portmap/Config.in"
source "package/quagga/Config.in"
source "package/sslsplit/Config.in"
source "package/ssmtp/Config.in"
source "package/strongswan/Config.in"
source "package/tacplus/Config.in"
source "package/tcpdump/Config.in"
source "package/tinyproxy/Config.in"
source "package/tinysvcmdns/Config.in"
source "package/twamp-protocol/Config.in"
source "package/vrrpd/Config.in"
source "package/udpxy/Config.in"
source "package/softflowd/Config.in"
source "package/libradius/Config.in"
source "package/remserial/Config.in"
endmenu

menu "Debugging, profiling and benchmark"
source "package/libunwind/Config.in"
source "package/memwatch/Config.in"
source "package/strace/Config.in"
source "package/valgrind/Config.in"
endmenu

menu "Interpreter languages and scripting"
source "package/lua/Config.in"
source "package/lua-ev/Config.in"
source "package/nodejs/Config.in"
endmenu

menu "Filesystem and flash utilities"
source "package/cpio/Config.in"
source "package/genext2fs/Config.in"
source "package/mtd/Config.in"
endmenu

menu "Development tools"
source "package/gperf/Config.in"
endmenu

endmenu
```

## package/accel-ppp/Config.in
```kconfig
config BR2_PACKAGE_ACCEL_PPP
	bool "pppoe/pptp/l2tp server"
	select BR2_LEGACY
	select BR2_PACKAGE_OPENSSL
```

## package/accel-pptp/Config.in
```kconfig
menuconfig BR2_PACKAGE_ACCEL_PPTP
	bool "accel-pptp"

if BR2_PACKAGE_ACCEL_PPTP
	config BR2_ACCEL_PPTP_VERSION
		string "Accel-pptp branch (default branch if empty)"
endif
```

## package/arptables/Config.in
```kconfig
config BR2_PACKAGE_ARPTABLES
	bool "arptables"
	help
	  

	  git//rd/sdk_packages
```

## package/busybox/Config.in
```kconfig
menuconfig BR2_PACKAGE_BUSYBOX
	bool "BusyBox"
	default y
	help
	  The Swiss Army Knife of embedded Linux.  It slices, it dices, it
	  makes Julian Fries.

	  http://busybox.net/

	  Most people will answer Y.

if BR2_PACKAGE_BUSYBOX

config BR2_BUSYBOX_VERSION
	string "branch (master if empty)"

config BR2_PACKAGE_BUSYBOX_CONFIG
	string "BusyBox configuration file to use?"
	default "package/busybox/mts.config"
	help
		Some people may wish to use their own modified BusyBox configuration
		file, and will specify their config file location with this option.
		Most people will just use the default BusyBox configuration file.

config BR2_BUSYBOX_ARP
	bool "arp"
	default n

config BR2_BUSYBOX_BPF_IN_UDHCP
	bool "bpf filter in udhcp"
	default y

config BR2_BUSYBOX_CHMOD
	bool "chmod"

config BR2_BUSYBOX_DMESG
	bool "dmesg"

config BR2_BUSYBOX_GZIP
	bool "gZip"

config BR2_BUSYBOX_HTTPD_AUTH
	bool "http authentication (with crypted passwords)"

config BR2_BUSYBOX_IFCONFIG
	bool "ifconfig"
	default y

config BR2_BUSYBOX_INETD
	bool "inetd"

config BR2_BUSYBOX_INIT
	bool "init"
	depends on !BR2_DSYSINIT
	default y

config BR2_BUSYBOX_IP_UTILS
	bool "ip_utils"
	default y

if BR2_BUSYBOX_IP_UTILS

	config BR2_BUSYBOX_IP
		bool "ip"
		default y

	config BR2_BUSYBOX_IPADDR
		bool "ipaddr"
		default y

	config BR2_BUSYBOX_IPLINK
		bool "iplink"
		default y

	config BR2_BUSYBOX_IPROUTE
		bool "iproute"
		default y

	config BR2_BUSYBOX_IPTUNNEL
		bool "iptunnel"
		default y

	config BR2_BUSYBOX_IPRULE
		bool "iprule"
		default y

	config BR2_BUSYBOX_IPNEIGH
		bool "ipneigh"
		default y
endif

config BR2_BUSYBOX_LSPCI
	bool "lspci"
	depends on BR2_USB_SUPPORT
	depends on !BR2_PACKAGE_HOTPLUG # hotplug поставляет lspci

config BR2_BUSYBOX_LSUSB
	bool "lsusb"
	depends on BR2_USB_SUPPORT
	depends on !BR2_PACKAGE_HOTPLUG # hotplug поставляет lsusb

config BR2_BUSYBOX_NICE
	bool "nice"

config BR2_BUSYBOX_NTP
	bool "ntp (client)"

if BR2_BUSYBOX_NTP
config BR2_BUSYBOX_NTP_SERVER
	bool "ntp (server)"
	help
	  Is used to add an NTP-server to the NTP-client

config BR2_BUSYBOX_NTP_CONFIG_FILE
	bool "ntp config file"
	help
	  To use the configuration file /etc/ntp.conf
endif

config BR2_BUSYBOX_SWAP
	bool "swap"

config BR2_BUSYBOX_TAR
	bool "tar"

config BR2_BUSYBOX_TELNETD
	bool "telnetd"
	default y

config BR2_BUSYBOX_TFTP
	bool "tftp client"

config BR2_BUSYBOX_SYNC
	bool "sync"
	default n

config BR2_BUSYBOX_FLASH_ERASEALL
	bool "flash_eraseall"
	default n

config BR2_BUSYBOX_MKNOD
	bool "mknod"
	default n
	help
	  mknod is used to create FIFOs or block/character special
	  files with the specified names.

menu "UBI tools"

config BR2_BUSYBOX_NANDWRITE
	bool "nandwrite"
	default n
	help
	  Write to the specified MTD device, with bad blocks awareness

config BR2_BUSYBOX_NANDDUMP
	bool "nanddump"
	default n
	help
	  Dump the content of raw NAND chip

config BR2_BUSYBOX_UBIATTACH
	bool "ubiattach"
	default n
	help
	  Attach MTD device to an UBI device.

config BR2_BUSYBOX_UBIDETACH
	bool "ubidetach"
	default n
	help
	  Detach MTD device from an UBI device.

config BR2_BUSYBOX_UBIMKVOL
	bool "ubimkvol"
	default n
	help
	  Create a UBI volume.

config BR2_BUSYBOX_UBIRMVOL
	bool "ubirmvol"
	default n
	help
	  Delete a UBI volume.

config BR2_BUSYBOX_UBIRSVOL
	bool "ubirsvol"
	default n
	help
	  Resize a UBI volume.

config BR2_BUSYBOX_UBIUPDATEVOL
	bool "ubiupdatevol"
	default n
	help
	  Update a UBI volume.

endmenu

config BR2_BUSYBOX_SMP_TOP
	bool "SMP top"
	default n

config BR2_BUSYBOX_ASH_BASH_COMPAT
	bool "enable bashisms for ash"
	default y

endif
```

## package/ca-certificates/Config.in
```kconfig
config BR2_PACKAGE_CA_CERTIFICATES
	bool "CA Certificates"
	default n
	help
	  This package includes PEM files of CA certificates to allow
	  SSL-based applications to check for the authenticity of SSL
	  connections.

	  It includes, among others, certificate authorities used by the
	  Debian infrastructure and those shipped with Mozilla's
	  browsers.

	  https://salsa.debian.org/debian/ca-certificates

if BR2_PACKAGE_CA_CERTIFICATES

	choice
		prompt "Certificate installation type"
		default BR2_PACKAGE_CA_CERTIFICATES_BUNDLE_ONLY

		config BR2_PACKAGE_CA_CERTIFICATES_BUNDLE_ONLY
			bool "Install ca_certificates.crt file only"
			help
			  Install only the bundle file ca_certificates.crt without *.pem files and hash files.

		config BR2_PACKAGE_CA_CERTIFICATES_FULL
			bool "Install all certificates"
			help
			  Install the bundle file ca_certificates.crt along with *.pem files and hash files.

	endchoice

endif
```

## package/cereal/Config.in
```kconfig
menuconfig BR2_PACKAGE_CEREAL
	bool "cereal"
	default n
	help
		cereal - A C++11 library for serialization

if BR2_PACKAGE_CEREAL

config BR2_PACKAGE_CEREAL_INSTALL_HEADERS_ONLY
	bool "Install cereal headers only."
	default y
	help
		Copy only header files to the staging directory.

endif
```

## package/darkstat/Config.in
```kconfig
config BR2_PACKAGE_DARKSTAT
	bool "darkstat"
	select BR2_LEGACY
	select BR2_PACKAGE_LIBPCAP
	help
	  Captures network traffic, calculates statistics about usage, and serves reports over HTTP.

	  https://unix4lyfe.org/darkstat/
```

## package/dnsmasq/Config.in
```kconfig
menuconfig BR2_PACKAGE_DNSMASQ
	bool "dnsmasq"
	help
		A lightweight DNS and DHCP server.  It is intended to provide
		coupled DNS and DHCP service to a LAN.
		http://www.thekelleys.org.uk/dnsmasq/

if BR2_PACKAGE_DNSMASQ

config BR2_PACKAGE_DNSMASQ_TFTP
	bool "tftp support"
	default n
	depends on BR2_PACKAGE_DNSMASQ
	help
		Enable TFTP support in dnsmasq.

config BR2_PACKAGE_DNSMASQ_DHCP
	bool "dhcp support"
	default y
	depends on BR2_PACKAGE_DNSMASQ
	help
		Enable DHCP server support in dnsmasq.

config BR2_PACKAGE_DNSMASQ_IDN
	bool "IDN support (BIG!)"
	depends on BR2_PACKAGE_DNSMASQ
	select BR2_PACKAGE_LIBINTL
	select BR2_PACKAGE_LIBIDN
	help
		Enable IDN support in dnsmasq.
		This option is a big space taker since is pulls in many libraries.

config BR2_PACKAGE_DNSMASQ_BIND_DNS_WAN_IFACE
	bool "support binding wan iface for dns"
	default n
	depends on BR2_PACKAGE_DNSMASQ
	help
		Enable for alternative route for default wan interfaces from special lan interface.
		DNS packet set wan as oif iface.
		Eхample: interface=br0,br0.3[ppp0] // ppp0 not default (main table) and use only for br0.3 lan.

config BR2_SUPPORT_YANDEX_DNS
	bool "Yandex DNS"
	default n
	depends on BR2_PACKAGE_DNSMASQ

config BR2_PACKAGE_DNSMASQ_CONNTRACK
	bool "Support conntrack"
	default n
	depends on BR2_PACKAGE_DNSMASQ

config BR2_SUPPORT_SAFEDNS
	bool "SafeDNS"
	default n
	depends on BR2_PACKAGE_CIVETWEB
	depends on BR2_PACKAGE_DNSMASQ
	select BR2_CIVETWEB_CGI
	select BR2_CIVETWEB_HTTPS
	select BR2_PACKAGE_LIBCURL
	select BR2_PACKAGE_LIBCURL_WITH_HTTP
	select BR2_PACKAGE_LIBCURL_WITH_OPENSSL
	select BR2_PACKAGE_SSLSPLIT

endif

menuconfig  BR2_PACKAGE_DNSMASQ_RESOLV
    bool "dnsmasq resolv"
    help
        Resolv dns with dnsmasq, used resolv-file=/tmp/resolv_dnsmasq.conf for nameservers.
        Not used /etc/resolv.conf
    default n
    depends on BR2_PACKAGE_DNSMASQ

    if BR2_PACKAGE_DNSMASQ_RESOLV
         config BR2_PACKAGE_DNSMASQ_RESOLV_MAXNS
         int "max nameservers for dnsmasq_resolv"
         default 5
         depends on BR2_PACKAGE_DNSMASQ && BR2_PACKAGE_DNSMASQ_RESOLV
    endif
```

## package/domoticz/Config.in
```kconfig
menuconfig BR2_PACKAGE_DOMOTICZ
	bool "domoticz"
	depends on BR2_USE_MMU # mosquitto
	depends on BR2_TOOLCHAIN_HAS_THREADS_NPTL
	depends on BR2_INSTALL_LIBSTDCPP
	depends on BR2_USE_WCHAR
	depends on BR2_PACKAGE_LUA_5_3
	select BR2_PACKAGE_BOOST
	select BR2_PACKAGE_BOOST_DATE_TIME
	select BR2_PACKAGE_BOOST_SYSTEM
	select BR2_PACKAGE_BOOST_THREAD
	select BR2_PACKAGE_LIBCURL
	select BR2_PACKAGE_LIBCURL_WITH_SMTP
	select BR2_PACKAGE_LIBCURL_WITH_SMTPS
	select BR2_PACKAGE_OPENSSL
	select BR2_PACKAGE_OPENZWAVE
	select BR2_PACKAGE_SQLITE
	select BR2_PACKAGE_ZLIB
	select BR2_BUSYBOX_FLASH_ERASEALL # jffs2
	select BR2_PACKAGE_CEREAL
	help
	  Domoticz is a Home Automation System that lets you monitor
	  and configure various devices like: Lights, Switches,
	  various sensors/meters like Temperature, Rain, Wind, UV,
	  Electra, Gas, Water and much more. Notifications/Alerts can
	  be sent to any mobile device.

	  http://domoticz.com

if BR2_PACKAGE_DOMOTICZ

config BR2_PACKAGE_DOMOTICZ_SQLITEDB_PAGESIZE
	int "Set the page size for the SQLite database (512 - 65536 (degree 2), 0 - default/auto)"
	default 0
	help
	  To set the page size for the database.
	  The page size must be a power of two between 512 and 65536 inclusive.
	  0 - default.

config BR2_PACKAGE_DOMOTICZ_COMPRESS_DB_WITH_COPY_SETTINGS
	bool "Use compression for DB with copy of the settings."
	help
	  To use compression for the database with a copy of the settings.

config BR2_PACKAGE_DOMOTICZ_VERSION
	string "Domoticz version (used branch)"
	default "dlink-main"
	help
	  The branch used to build the package.

config BR2_PACKAGE_DOMOTICZ_USE_PRECOMPILED_HEADER
	bool "Use a precompiled header when building."
	default n
	help
	  To use a precompiled header when building Domoticz.
	  Enabling this option will shorten build time
	  (requires CMake version 3.16 or higher).

endif
```

## package/ebtables/Config.in
```kconfig
menuconfig BR2_PACKAGE_EBTABLES
	bool "ebtables"
	help
	  Ethernet bridge frame table administration

	  http://ebtables.sourceforge.net
if BR2_PACKAGE_EBTABLES
config BR2_EBTABLES_BRANCH
	string "ebtables branch (default if empty)"
endif

config BR2_EBTABLES_CUSTOMIZE
	bool "Check modules manually"
	depends on BR2_PACKAGE_EBTABLES
	default n
	help
	  Check ebtables modules to build/install.
	  If unset then all will be built/installed.

if BR2_EBTABLES_CUSTOMIZE

comment "tables"

config BR2_EBTABLES_TABLE_BROUTE
	bool "broute"
	default n

config BR2_EBTABLES_TABLE_FILTER
	bool "filter"
	default y

config BR2_EBTABLES_TABLE_NAT
	bool "nat"
	default n

comment "modules"

config BR2_EBTABLES_MOD_802_3
	bool "802_3"
	default n

config BR2_EBTABLES_MOD_AMONG
	bool "among"
	default n

config BR2_EBTABLES_MOD_ARP
	bool "arp"
	default y

config BR2_EBTABLES_MOD_ARPREPLY
	bool "arpreply"
	default n

config BR2_EBTABLES_MOD_IP6
	bool "ip6"
	default n

config BR2_EBTABLES_MOD_IP
	bool "ip"
	default n

config BR2_EBTABLES_MOD_LIMIT
	bool "limit"
	default n

config BR2_EBTABLES_MOD_LOG
	bool "log"
	default n

config BR2_EBTABLES_MOD_MARK
	bool "mark"
	default n

config BR2_EBTABLES_MOD_MARK_M
	bool "mark_m"
	default n

config BR2_EBTABLES_MOD_NAT
	bool "nat"
	default n

config BR2_EBTABLES_MOD_NFLOG
	bool "nflog"
	default n

config BR2_EBTABLES_MOD_PKTTYPE
	bool "pkttype"
	default n

config BR2_EBTABLES_MOD_REDIRECT
	bool "redirect"
	default n

config BR2_EBTABLES_MOD_STANDARD
	bool "standard"
	default y

config BR2_EBTABLES_MOD_STP
	bool "stp"
	default n

config BR2_EBTABLES_MOD_ULOG
	bool "ulog"
	default n

config BR2_EBTABLES_MOD_VLAN
	bool "vlan"
	default n

endif
```
