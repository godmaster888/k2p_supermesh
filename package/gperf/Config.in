## package/gperf/Config.in
```kconfig
config BR2_PACKAGE_GPERF
	bool "gperf"
	default n
	help
	  GNU gperf is a perfect hash function generator.
	  The hash function is perfect, which means that
	  the hash table has no collisions, and the hash
	  table lookup needs a single string comparison only.

	  https://www.gnu.org/software/gperf/
```

## package/gpp/Config.in
```kconfig
config BR2_PACKAGE_GPP
	bool "gpp"
	help
	  General-purpose preprocessor with customizable syntax

	  https://logological.org/gpp
```

## package/hostapd/Config.in
```kconfig
menuconfig BR2_PACKAGE_HOSTAPD
	bool "hostapd"
	select BR2_PACKAGE_LIBNL if BR2_bcm
	select BR2_PACKAGE_LIBNL_TINY
	select BR2_PACKAGE_QCA_WIFI if BR2_WIFI_DRIVER_QCA
	help
		hostapd is a user space daemon for access point and authentication servers. It implements IEEE 802.11 access point management, IEEE 802.1X/WPA/WPA2/EAP Authenticators, RADIUS client, EAP server, and RADIUS authentication server.
		http://hostap.epitest.fi/hostapd/

if BR2_PACKAGE_HOSTAPD

config BR2_PACKAGE_HOSTAPD_CONFIG
	string "path to build config"

config BR2_PACKAGE_HOSTAPD_ACS
	bool "Enable ACS"
	default y

config BR2_PACKAGE_HOSTAPD_EAP
	bool "Enable EAP"

config BR2_PACKAGE_HOSTAPD_WPS
	bool "Enable WPS"

comment "hostapd: install additional"

config BR2_PACKAGE_HOSTAPD_INSTALL_CLI
	bool "hostapd_cli"
	default n

config BR2_PACKAGE_HOSTAPD_INSTALL_CONF
	bool "hostapd.conf"
	default n
	help
	  A config is normally runtime generated, so you
	  definitely do not need this.


comment "wpa_supplicant:"
config BR2_PACKAGE_HOSTAPD_WPASUPP
	bool "wpa_supplicant"
	default y
	help
	  Build and install wpa_supplicant.


if BR2_PACKAGE_HOSTAPD_WPASUPP

config BR2_PACKAGE_HOSTAPD_WPASUPP_MESH
	bool "MESH"
	default y
config BR2_PACKAGE_HOSTAPD_WPASUPP_P2P
	bool "P2P"
	default n

endif # BR2_PACKAGE_HOSTAPD_WPASUPP


endif # BR2_PACKAGE_HOSTAPD
```

## package/igmpproxy/Config.in
```kconfig
menuconfig BR2_PACKAGE_IGMPPROXY
	bool "Igmp proxy"
	default n
	select BR2_LEGACY

if BR2_PACKAGE_IGMPPROXY
config BR2_PACKAGE_IGMPPROXY_BRANCH
	string "igmpproxy git branch (default if empty)"
endif
```

## package/improxy/Config.in
```kconfig
config BR2_PACKAGE_IMPROXY
	bool "improxy"
	depends on BR2_INET_IPV6
	default n
	help
	  IGMP/MLD proxy
```

## package/inadyn/Config.in
```kconfig
menuconfig BR2_PACKAGE_INADYN
	bool "inadyn - DDNS update client"
	default n
	select BR2_PACKAGE_LIBCONFUSE
	select BR2_PACKAGE_LIBITE
	help
	  INADYN is a free DynDNS client. It gives the possibility
	  to have your own fixed hostname registered on the internet,
	  although your IP might be changing.

	  https://github.com/troglobit/inadyn

if BR2_PACKAGE_INADYN

config BR2_PACKAGE_INADYN_SSL
	bool "Enable Openssl"
	default n
	depends on BR2_PACKAGE_OPENSSL

endif
```

## package/iproute2/Config.in
```kconfig
menuconfig BR2_PACKAGE_IPROUTE2
	bool "iproute2"
	help
	  Kernel routing and traffic control utilities.  Provides things
	  like ip and tc.

	  http://www.linuxfoundation.org/collaborate/workgroups/networking/iproute2

if BR2_PACKAGE_IPROUTE2

choice
	prompt "iproute2 kernel version"
	config BR2_IPROUTE2_2_6_22
		bool "2.6.22"
		select BR2_IPROUTE2_LOCAL_SITE

	config BR2_IPROUTE2_3_10_0
		bool "3.10.0"

	config BR2_IPROUTE2_4_11_0
		bool "4.11.0"

	config BR2_IPROUTE2_4_18_0
		bool "4.18.0"

endchoice

config BR2_IPROUTE2_VERSION
	string
	default "2.6.22"  if BR2_IPROUTE2_2_6_22
	default "3.10.0"  if BR2_IPROUTE2_3_10_0
	default "4.11.0"  if BR2_IPROUTE2_4_11_0
	default "4.18.0"  if BR2_IPROUTE2_4_18_0


config BR2_IPROUTE2_MODULE_IP
	bool "Enable ip modules"
	depends on !BR2_BUSYBOX_IP_UTILS
	help
		IP modules: ip link, ip addr, ip neighbor, ip rule, ip route, ip tunnel, ip maddr, ip mroute, ip monitor.

# if BR2_IPROUTE2_MODULE_IP

# 	config BR2_IPROUTE2_MODULE_IP_ADDR
# 		bool"ip addr"
# 		help
# 			Enable module "ip addr": allows users to look at addresses and their properties, add new addresses, and delete old ones
# 	config BR2_IPROUTE2_MODULE_IP_LINK
# 		bool"ip link"
# 		help
# 			Enable module "ip link": allows users to look at the state of devices and to make changes
# 	config BR2_IPROUTE2_MODULE_IP_MADDR
# 		bool"ip maddr"
# 		help
# 			Enable module "ip maddr": allows users to look at the multicast addresses and their properties, and change them
# 	config BR2_IPROUTE2_MODULE_IP_MROUTE
# 		bool"ip mroute"
# 		help
# 			Enable module "ip mroute": allows users to set, change, or delete the multicast routing
# 	config BR2_IPROUTE2_MODULE_IP_MONITOR
# 		bool"ip monitor"
# 		help
# 			Enable module "ip monitor": allows users to continuously monitor the state of devices, addresses and routes

# 	config BR2_IPROUTE2_MODULE_IP_NEIGH
# 		bool"ip neighbor"
# 		help
# 			Enable module "ip neighbor": allows users to look at neighbor bindings and their properties, add new neighbor entries, and delete old ones
# 	config BR2_IPROUTE2_MODULE_IP_RULE
# 		bool"ip rule"
# 		help
# 			Enable module "ip rule": allows users to look at the routing policies and change them
# 	config BR2_IPROUTE2_MODULE_IP_ROUTE
# 		bool"ip route"
# 		help
# 			Enable module "ip route": allows users to look at the routing table and change routing table rules
# 	config BR2_IPROUTE2_MODULE_IP_TUNNEL
# 		bool"ip tunnel"
# 		help
# 			Enable module "ip tunnel": allows users to look at the IP tunnels and their properties, and change them

# endif #BR2_IPROUTE2_MODULE_IP

config BR2_IPROUTE2_MODULE_BRIDGE
	bool "bridge"
	# mb depends on !brctl in busybox
	help
		Enable module "bridge": configures network bridges.

config BR2_IPROUTE2_MODULE_LNSTAT
	bool "lnstat"
	help
		Enable module "lnstat": Provides Linux network statistics. It is a generalized and replacement old rtstat program.

# if BR2_IPROUTE2_MODULE_LNSTAT
# 	config BR2_IPROUTE2_MODULE_CTSTAT
# 		bool "ctstat"
# 		help
# 			Enable module "ctstat": connection status utility.

# 	config BR2_IPROUTE2_MODULE_RTSTAT
# 		bool "rtstat"
# 		help
# 			Enable module "rtstat": route status utility.
# endif #BR2_IPROUTE2_MODULE_LNSTAT

config BR2_IPROUTE2_MODULE_GENL
	bool "genl"
	help
		Enable module "genl": simple frontend to the generic netlink library. Now only the ctrl object is available, which is used to query the generic netlink controller.


config BR2_IPROUTE2_MODULE_IFCFG
	bool "ifcfg"
	# depends on arping and rdisk
	help
		Enable script "ifcfg": script wrapper for the ip command. Requires the arping and rdisk programs from the 'iputils' package found at.

config BR2_IPROUTE2_MODULE_IFSTAT
	bool "ifstat"
	help
		Enable module "ifstat": shows the interface statistics, including the amount of transmitted and received packets by interface.

config BR2_IPROUTE2_MODULE_IFSTAT
	bool "ifstat"
	help
		Enable module "ifstat": shows the interface statistics, including the amount of transmitted and received packets by interface.

config BR2_IPROUTE2_MODULE_NSTAT
	bool "nstat"
	help
		Enable module "nstat": shows network statistics.

config BR2_IPROUTE2_MODULE_RT
	bool "rtacct, rtmon"
	help
		Enable module "rtacct, rtmon": rtactt - displays the contents of /proc/net/rt_acct, rtmon - route monitoring utility.

config BR2_IPROUTE2_MODULE_ROUT_TABLE
	bool "routef,routel"
	depends on BR2_IPROUTE2_MODULE_IP
	help
		Enable scripts "routef,routel": routel - listing the routing tables, routef -  flushing the routing tables.

config BR2_IPROUTE2_MODULE_SS
	bool "ss"
	help
		Enable module "ss": similar to the netstat command - shows active connections.

config BR2_IPROUTE2_MODULE_TC
	bool "tc"
	help
		Enable module "tc": traffic controlling Executable. This is for Quality Of Service (QOS) and Class Of Service (COS) implementations.

endif
```

## package/ipsec-tools/Config.in
```kconfig
config BR2_PACKAGE_IPSEC_TOOLS
	bool "ipsec-tools"
	select BR2_PACKAGE_OPENSSL
	help
	  This package is required to support IPSec for Linux 2.6+
```

## package/iw/Config.in
```kconfig
config BR2_PACKAGE_IW
	bool "iw"
	select BR2_PACKAGE_LIBNL_TINY

if BR2_PACKAGE_IW

config BR2_IW_VERSION
	string "iw branch (3.6 if empty)"
	default "4.9" if BR2_qca
	default "3.6"

endif
```

## package/jansson/Config.in
```kconfig
config BR2_PACKAGE_JANSSON
	bool "jansson"
	help
	   Build C library for encoding, decoding and manipulating JSON data.
```

## package/kprofile/Config.in
```kconfig
menuconfig BR2_PACKAGE_KPROFILE
	bool "Kernel profiling"
	default n
	select BR2_LEGACY
	help
		Tools to profile kernel bottlnecks.
		You need to enable CONFIG_PROFILING in kernel
		and load it with (for example) "profile=2" cmd option.
		And provide System.map.

if BR2_PACKAGE_KPROFILE
	config BR2_KPROFILE_READPROFILE
		bool "readprofile"
		default y
		help
			From util-linux-2.24

	config BR2_KPROFILE_KERNELTOP
		bool "kerneltop"
		default y
		help
			Based on readprofile.
endif
```

## package/lanauth/Config.in
```kconfig
config BR2_PACKAGE_LANAUTH
	bool "kabinet"
	select BR2_LEGACY
	select BR2_PACKAGE_LIBTOMCRYPT
	help
	  This package for provider KABINET

	  $(DLINK_GIT_STORAGE)/lanauth
```

## package/libcrc/Config.in
```kconfig
config BR2_PACKAGE_LIBCRC
	bool "libcrc"
	help
	  LibCRC is an MIT licensed library written in C containing various
	  checksum algorithms. These include the most common CRC implementations
	  but also other checksums like the NMEA checksum used by marine equipment.

	  https://www.libcrc.org/
```

## package/libctelebot/Config.in
```kconfig
config BR2_PACKAGE_LIBCTELEBOT
	select BR2_PACKAGE_JANSSON
	select BR2_PACKAGE_LIBCURL
	bool "libctelebot"
	default n
	help
		Telegram bot API library
		https://github.com/pogudaev/libctelebot.git
```

## package/libcurl/Config.in
```kconfig
menuconfig BR2_PACKAGE_LIBCURL
	bool "libcurl"
	default n

if BR2_PACKAGE_LIBCURL

config BR2_PACKAGE_LIBCURL_WITH_HTTP
	bool "Enable libcurl HTTP support"
	default y

config BR2_PACKAGE_LIBCURL_WITH_FTP
	bool "Enable libcurl FTP support"
	default n

config BR2_PACKAGE_LIBCURL_WITH_TFTP
	bool "Enable libcurl TFTP support"
	default n

config BR2_PACKAGE_LIBCURL_WITH_FILE
	bool "Enable libcurl FILE support"
	default n

config BR2_PACKAGE_LIBCURL_WITH_COOKIES
	bool "Enable libcurl cookies support"
	default n

config BR2_PACKAGE_LIBCURL_WITH_CRYPTO_AUTH
	bool "Enable libcurl cryptographic authentication"
	default n

config BR2_PACKAGE_LIBCURL_WITH_SMTP
	bool "Enable libcurl SMTP support"
	default n

config BR2_PACKAGE_LIBCURL_WITH_SMTPS
	depends on BR2_PACKAGE_LIBCURL_WITH_OPENSSL || BR2_PACKAGE_LIBCURL_WITH_AXTLS || BR2_PACKAGE_LIBCURL_WITH_CYASSL
	bool "Enable libcurl SMTPS support"
	default n

comment "to use libcurl SMTPS, enable crypto lib first"
	depends on !BR2_PACKAGE_LIBCURL_WITH_OPENSSL && !BR2_PACKAGE_LIBCURL_WITH_AXTLS && !BR2_PACKAGE_LIBCURL_WITH_CYASSL

choice
	prompt "crypto lib:"
	default BR2_PACKAGE_LIBCURL_NO_SSL
	config BR2_PACKAGE_LIBCURL_NO_SSL
		bool "no"
	config BR2_PACKAGE_LIBCURL_WITH_OPENSSL
		#depends on BR2_PACKAGE_OPENSSL
		bool "openssl"
	config BR2_PACKAGE_LIBCURL_WITH_AXTLS
		depends on BR2_PACKAGE_AXTLS
		bool "axtls"
	config BR2_PACKAGE_LIBCURL_WITH_CYASSL
		depends on BR2_PACKAGE_LIBCYASSL
		bool "cyassl"
endchoice

config BR2_PACKAGE_LIBCURL_BIN
	bool "install libcurl bin"
	default n
	help
	  Install executable libcurl.

endif
```

## package/libcyassl/Config.in
```kconfig
config BR2_PACKAGE_LIBCYASSL
	bool "libcyassl (enables HTTPS)"
	default n
	help
		http://www.yassl.com/cyassl-2.8.0.zip
```

## package/libeXosip2/Config.in
```kconfig
menuconfig BR2_PACKAGE_LIBEXOSIP2
	bool "libeXosip2"
	default n
	select BR2_PACKAGE_LIBOSIP2
	help
	  eXosip is a GPL library that  extend  the  capability  of the oSIP library. It aims  to  implement  a  simple  high layer API to control SIP (rfc3261) for sessions establishements and common extensions.
	  http://www.antisip.com

if BR2_PACKAGE_LIBEXOSIP2

config BR2_PACKAGE_LIBEXOSIP2_TOOLS
	bool "tools"
	default n
	help
	  example execute file for test eXosip

config BR2_PACKAGE_LIBEXOSIP2_OPENSSL
	bool "use openssl"
	default y
	depends on BR2_PACKAGE_OPENSSL
	help
	  build with support openssl

config BR2_PACKAGE_LIBEXOSIP2_SRV_DNS
	bool "support SRV DNS"
	default y
	help
	  build with support SRV DNS

config BR2_PACKAGE_LIBEXOSIP2_MULTITHREAD
	bool "support multithread"
	default y
	help
	  build with support multithread

config BR2_PACKAGE_LIBEXOSIP2_MINIMIZE
	bool "minimize build"
	default n
	help
	  only compile minimal voip related code

choice
	prompt "Version"
	default BR2_PACKAGE_LIBEXOSIP2_V5_1

config BR2_PACKAGE_LIBEXOSIP2_V5_0
	bool "v5.0.0"

config BR2_PACKAGE_LIBEXOSIP2_V5_1
	bool "v5.1.0"

endchoice

endif
```

## package/libev/Config.in
```kconfig
config BR2_PACKAGE_LIBEV
	bool "libev"
	default n
	help
	  Userspace library for handling asynchronous notifications

	  http://software.schmorp.de/pkg/libev.html
	  https://salsa.debian.org/debian/libev
```
