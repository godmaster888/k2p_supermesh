## package/libnfnetlink/Config.in
```kconfig
config BR2_PACKAGE_LIBNFNETLINK
	bool "libnfnetlink"
	help
		A low-level library for netfilter related kernel/userspace communication.
```

## package/libnl-tiny/Config.in
```kconfig
config BR2_PACKAGE_LIBNL_TINY
	bool "libnl-tiny"
	help
		This package contains a stripped down version of libnl.
```

## package/libortp/Config.in
```kconfig
config BR2_PACKAGE_LIBORTP
	bool "libortp"
	default n
	help
	  oRTP is a library implemeting Real-time Transport Protocol (RFC 3550), distributed under GNU GPLv2 or proprietary license.

	  http://www.linphone.org
```

## package/libosip2/Config.in
```kconfig
menuconfig BR2_PACKAGE_LIBOSIP2
	bool "libosip2"
	default n
	help
	  oSIP is an LGPL implementation of SIP. It's stable, portable, flexible and compliant!

	  http://www.antisip.com

if BR2_PACKAGE_LIBOSIP2
config BR2_PACKAGE_LIBOSIP2_MULTITHREAD
	bool "support multithread"
	default y
	help
	  build with support multithread

config BR2_PACKAGE_LIBOSIP2_MINIMIZE
	bool "minimize build"
	default n
	help
	  only compile minimal voip related code

choice
	prompt "Version"
	default BR2_PACKAGE_LIBOSIP2_V5_1

config BR2_PACKAGE_LIBOSIP2_V5_0
	bool "v5.0.0"

config BR2_PACKAGE_LIBOSIP2_V5_1
	bool "v5.1.0"

endchoice

endif
```

## package/libradius/Config.in
```kconfig
config BR2_PACKAGE_LIBRADIUS
	bool "libradius"
	select BR2_PACKAGE_LIBMD5_RFC
	default n
```

## package/libumqtt/Config.in
```kconfig
menuconfig BR2_PACKAGE_LIBUMQTT
	bool "libumqtt"
	default n
	select BR2_PACKAGE_LIBEV
	help
	  Client library MQTT implementation.
```

## package/memwatch/Config.in
```kconfig
config BR2_PACKAGE_MEMWATCH
	bool "memwatch v2.71"
	default n
	help
		Memory compile-time debugger
		from http://www.linkdata.se/downloads/sourcecode/memwatch/memwatch-2.71.tar.gz
		DO NOT USE IT IN RELEASES!!!
		Selectig this tht few packages: ls/res/tr069 will be
		built with support of memwatch.
```

## package/mini_upnp_rlt/Config.in
```kconfig
config BR2_PACKAGE_MINI_UPNP_RLT
	bool "mini_upnp_rtl"
	depends on BR2_rlx_wifi
	help
	  For Realtek WPS daemon.

config BR2_MINI_UPNP_RLT_VERSION
	string "miniupnp-version"
	depends on BR2_PACKAGE_MINI_UPNP_RLT
	default "3.4.11C"
```

## package/minidlna/Config.in
```kconfig
config BR2_PACKAGE_MINIDLNA
	bool "MiniDLNA"
	select BR2_PACKAGE_SQLITE
	select BR2_PACKAGE_LIBEXIF
	select BR2_PACKAGE_LIBID3TAG
	select BR2_PACKAGE_LIBJPEG
	select BR2_PACKAGE_ZLIB
	help
	  MiniDLNA server

if BR2_PACKAGE_MINIDLNA

choice
	prompt "Branch"
	default BR2_PACKAGE_MINIDLNA_VERSION_ADVANCED

config BR2_PACKAGE_MINIDLNA_VERSION_ADVANCED
	bool "advanced (stable)"
	help
	  Stable branch without FLAC and OGG support

config BR2_PACKAGE_MINIDLNA_VERSION_1_2_1
	bool "1.2.1 (Sep 2020)"
	select BR2_PACKAGE_LIBFLAC
	select BR2_PACKAGE_LIBVORBIS
	help
	  Branch of September 2020 with FLAC and OGG support

endchoice

endif
```

## package/miniupnpd/Config.in
```kconfig
config BR2_PACKAGE_MINIUPNPD
	bool "miniupnpd"
	select BR2_PACKAGE_OPENSSL
	select BR2_PACKAGE_LIBNFNETLINK
	select BR2_PACKAGE_IPTABLES
	select BR2_PACKAGE_UTIL_LINUX
	select BR2_PACKAGE_UTIL_LINUX_LIBUUID
	default y
	help
		Mini UPnPd is a lightweight implementation of a UPnP IGD daemon.

if BR2_PACKAGE_MINIUPNPD
config BR2_SUPPORT_MINIUPNPD_OUTPORT
	bool "support output port"
	default n
endif

if BR2_PACKAGE_MINIUPNPD
config BR2_SUPPORT_MINIUPNPD_IPV6_ENABLED
	depends on BR2_INET_IPV6
	bool "miniupnpd IPv6 and IGDv2 support (DANGEROUS)"
	default n
endif
```

## package/miredo/Config.in
```kconfig
config BR2_PACKAGE_MIREDO
	bool "miredo"
	depends on BR2_INET_IPV6
	default n
	help
	  Teredo
```

## package/mosquitto/Config.in
```kconfig
menuconfig BR2_PACKAGE_MOSQUITTO
	bool "mosquitto"
	default n
	help
	  "Official" MQTT implementation.

if BR2_PACKAGE_MOSQUITTO

	config BR2_PACKAGE_MOSQUITTO_VERSION
		string "Used branch (default if empty)"

#	menu "Options/Features"
	comment "Options/Features"

		comment "**  Global"
		if !BR2_PACKAGE_OPENSSL
			comment "You have to enable OpenSSL package"
			comment "to get TLS support in mosquitto"
		endif
		config BR2_PACKAGE_MOSQUITTO_FEAT_TLS
			bool "TLS"
			depends on BR2_PACKAGE_OPENSSL
			default y

		if BR2_PACKAGE_MOSQUITTO_FEAT_TLS
			config BR2_PACKAGE_MOSQUITTO_FEAT_TLS_PSK
				bool "TLS-PSK"
				default y

			config BR2_PACKAGE_MOSQUITTO_FEAT_TLS_EC
				bool "Elliptic Curve"
				default y
		endif

		config BR2_PACKAGE_MOSQUITTO_FEAT_SOCKS5
			bool "SOCKS5"
			default n

		config BR2_PACKAGE_MOSQUITTO_FEAT_SRV
			bool "SRV lookup (ingored. see help)"
			default n
			help
			  This needs c-ares library, which is not
			  provided by us. So it will be ignored for now.

		config BR2_PACKAGE_MOSQUITTO_FEAT_UUID
			bool "UUID support"
			default n
			select BR2_PACKAGE_UTIL_LINUX
			select BR2_PACKAGE_UTIL_LINUX_LIBUUID
			help
			  Using UUID functionality from a util-linux libuuid.

		comment "**  Library"
		config BR2_PACKAGE_MOSQUITTO_FEAT_THREADING
			bool "Threading support"
			default y

		comment "**  Broker"
		if BR2_PACKAGE_MOSQUITTO_BIN_BROKER
			config BR2_PACKAGE_MOSQUITTO_FEAT_LIBMQTT
				bool "Link broker with libmosquitto"
				default y
				# не прокатило, слишком по-разному библа собирается для
				# брокера и клиентов. Пусть уж как есть.
				depends on 0
				help
				  By default a broker is being built with
				  library sources inside (like static lib).
				  If Y, mosquitto broker is linked shared.
				  It redused size, if the firmware contains
				  client utilities also. Else set N.
			config BR2_PACKAGE_MOSQUITTO_FEAT_BRIDGE
				bool "Bridge support"
				default y
				help
				  Include bridge support for connecting to other brokers
			config BR2_PACKAGE_MOSQUITTO_FEAT_LIBWRAP
				bool "tcp-wrappers support (DO NOT, we have no libwrap)"
				default n
			config BR2_PACKAGE_MOSQUITTO_FEAT_DBUP
				bool "database upgrade support (fake? recommended but not used in)"
				default y
			config BR2_PACKAGE_MOSQUITTO_FEAT_MEMTRACK
				bool "memory tracking"
				default y
			config BR2_PACKAGE_MOSQUITTO_FEAT_PERSIST
				bool "persistence support"
				default y
			config BR2_PACKAGE_MOSQUITTO_FEAT_SYSTREE
				bool "$SYS tree support"
				default y
			config BR2_PACKAGE_MOSQUITTO_FEAT_WEBSOCKS
				bool "websockets"
				default n
		endif # BR2_PACKAGE_MOSQUITTO_BIN_BROKER
#	endmenu

#	menu "Programs"
	comment "Programs"

		config BR2_PACKAGE_MOSQUITTO_BIN_LIB
			bool
			default n

		config BR2_PACKAGE_MOSQUITTO_BIN_BROKER
			bool "broker"
			default y
			select BR2_PACKAGE_MOSQUITTO_BIN_LIB
		config BR2_PACKAGE_MOSQUITTO_BIN_PASSWD
			bool "passwd utility"
			default y
			depends on BR2_PACKAGE_MOSQUITTO_BIN_BROKER
			depends on BR2_PACKAGE_MOSQUITTO_FEAT_TLS
			# или on ...TLS_PSK?

		config BR2_PACKAGE_MOSQUITTO_BIN_SUB
			bool "subscriber"
			default y
			select BR2_PACKAGE_MOSQUITTO_BIN_LIB

		config BR2_PACKAGE_MOSQUITTO_BIN_PUB
			bool "publisher"
			default y
			select BR2_PACKAGE_MOSQUITTO_BIN_LIB

#	endmenu
endif
```

## package/nanocom/Config.in
```kconfig
config BR2_PACKAGE_NANOCOM
	bool "nanocom"
	select BR2_LEGACY
	default n
	help
	  Terminal emulator
```

## package/nat_rtsp_module/Config.in
```kconfig
menuconfig BR2_PACKAGE_NAT_RTSP_MODULE
	bool "RTSP conntrack module"
	help
		RTSP conntrack module.
```

## package/ndisc6/Config.in
```kconfig
menuconfig BR2_PACKAGE_NDISC6
	bool "ndisc6"
	default n
	help
		Small collection of useful tools for IPv6 networking.

		http://www.remlab.net/ndisc6/

if BR2_PACKAGE_NDISC6

config BR2_NDISC6_NAME2ADDR
	bool "name2addr"
	default n

config BR2_NDISC6_NDISC6
	bool "ndisc6"
	default n

config BR2_NDISC6_RDISC6
	bool "rdisc6"
	default y

config BR2_NDISC6_TCPSPRAY
	bool "tcpspray"
	default n

config BR2_NDISC6_TCPTRACEROUTE6
	bool "tcptraceroute6"
	default n

config BR2_NDISC6_TRACEROUTE6
	bool "traceroute6"
	default n

endif
```

## package/net-snmp/Config.in
```kconfig
config BR2_PACKAGE_NET_SNMP
	bool "net-snmp"
	select BR2_PACKAGE_OPENSSL

if BR2_PACKAGE_NET_SNMP

config BR2_PACKAGE_NET_SNMP_SUPPORT_READ_WRITE
	bool "Support rw mibs"

config BR2_PACKAGE_NET_SNMP_DLINK_VERSION_CONFIG_MIBS
	bool "dlink-version-config-mibs"

endif
```
