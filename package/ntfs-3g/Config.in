## package/ntfs-3g/Config.in
```kconfig
config BR2_PACKAGE_NTFS_3G
	bool "ntfs-3g"
	default y
	depends on BR2_SUPPORT_STORAGE
	help
	  module for support NTFS read/write
```

## package/ntpclient/Config.in
```kconfig
config BR2_PACKAGE_NTPCLIENT
	bool "ntpclient"
	help
	  ntpclient is an NTP (RFC-1305) client for unix-alike computers. 
	  Its functionality is a small subset of xntpd, but IMHO performs better 
	  (or at least has the potential to function better) within that limited 
	  scope. Since it is much smaller than xntpd, it is also more relevant 
	  for embedded computers.
```

## package/openssl/Config.in
```kconfig
config BR2_PACKAGE_OPENSSL
	bool "openssl"
	select BR2_PACKAGE_ZLIB
	help
	  A collaborative effort to develop a robust, commercial-grade, fully
	  featured, and Open Source toolkit implementing the Secure Sockets
	  Layer (SSL v2/v3) and Transport Security (TLS v1) as well as a
	  full-strength general-purpose cryptography library.

	  http://www.openssl.org/

	  Note: Some helper scripts need perl.

if BR2_PACKAGE_OPENSSL

config BR2_PACKAGE_OPENSSL_BIN
	bool "openssl binary"
	help
	  Install the openssl binary and the associated helper scripts to the
	  target file system. This is a command line tool for doing various
	  cryptographic stuff.

config BR2_PACKAGE_OPENSSL_ENGINES
	bool "openssl additional engines"
	help
	  Install additional encryption engine libraries.

config BR2_PACKAGE_OPENSSL_OCF
	bool "openssl ocf support"
	depends on BR2_PACKAGE_OPENSSL
	help
	  Enable openssl cryptodev (OCF) hardware acceleration support.
	  This requires kernel patches from the ocf-linux project otherwise
	  you'll just have a bigger openssl library that works as usual.

	  http://ocf-linux.sourceforge.net/

config BR2_PACKAGE_OPENSSL_PURIFY
	bool "disable OpenSSL memory hacks (for Valgrind)"
	default y if BR2_PACKAGE_VALGRIND
	default n
	help
	  This options disables some specific OpenSSL hacks that confuse Valgrind,
	  so it can report these hacks as invalid read/unitialized values/etc.

config BR2_PACKAGE_OPENSSL_WITHOUT_CNF
	bool "don't install default openssl.cnf, man, misc, etc. files"
	default y
	help
	  This option removes the default files for OpenSSL,
	  which are installed by default in /etc/ssl/.
endif
```

## package/p910nd/Config.in
```kconfig
config BR2_PACKAGE_P910ND
	  bool "print server"
	  help
	  Tiny print server

config BR2_PACKAGE_P910ND_FIRMWARE
	  depends on BR2_PACKAGE_P910ND && BR2_USE_JFFS2_PARTITION_512K
	  bool "Support printserver firmware"
```

## package/poptop/Config.in
```kconfig
config BR2_PACKAGE_POPTOP
	bool "PPTP server (PoPToP ver. 1.4 if empty)"
	default n

if BR2_PACKAGE_POPTOP

config BR2_PACKAGE_POPTOP_VERSION
	string "PoPToP version"
	default "master"

endif
```

## package/pppd/Config.in
```kconfig
menuconfig BR2_PACKAGE_PPPD
	bool "pppd"
	help
		An implementation of the Point-to-point protocol.

if BR2_PACKAGE_PPPD
	config BR2_PPPD_VERSION
		string "Pppd branch (default branch if empty)"

	config BR2_PPPOE_PASSTHROUGHT_OVER_IFACE
		bool "Connect pppoe relay over wan iface"
		default n

	config BR2_PPPD_FILTER
		bool "Enable pppd filter (for on-demand mode)"
		select BR2_PACKAGE_LIBPCAP
		default y

	config BR2_PPPOE_MAX_PADI_ATTEMPTS
		int "Max number of PADI attempts"
		default 3

	config BR2_PPPOE_PADI_TIMEOUT
		int "PADI timeout"
		default 5

	config BR2_PPPD_DROP_OLD_SESSION
		bool "Send PADT with old session id on start pppd"
		default y
		help
			Send PADT with old session id on start pppd

	menuconfig BR2_PPPD_PLUGINS
		bool "Pppd plugins"
		default n
		help
			Plugins in pppd (like pptp, pppoe, l2tp)
	if BR2_PPPD_PLUGINS
		config BR2_PACKAGE_PPPD_PPTP
			depends on BR2_PACKAGE_PPPD
			select BR2_PACKAGE_ACCEL_PPTP
			bool "pptp"

		config BR2_PACKAGE_PPPD_PPPOE
			depends on BR2_PACKAGE_PPPD
			bool "pppoe"

		config BR2_PACKAGE_PPPD_PPPOA
			depends on BR2_PACKAGE_PPPD
			bool "pppoa"

		config BR2_PACKAGE_PPPD_RADIUS
			depends on BR2_PACKAGE_PPPD
			bool "radius"
			help
			  Install RADIUS support for pppd
			config BR2_PACKAGE_PPPD_L2TP
				depends on BR2_PACKAGE_PPPD
				bool "l2tp"
				default n
				help
					Work only use openl2tpd
	endif
endif
```

## package/pptpclient/Config.in
```kconfig
menuconfig BR2_PACKAGE_PPTPCLIENT
	bool "pptpclient"
	help
		https://git.code.sf.net/p/pptpclient/git

config BR2_PACKAGE_PPTPCLIENT_VERSION
	string "pptpclient version"
	default "rtl"
	depends on BR2_PACKAGE_PPTPCLIENT
```

## package/pure-ftpd/Config.in
```kconfig
config BR2_PACKAGE_PURE_FTPD
	bool "pure-ftpd"
	default y
	depends on BR2_SUPPORT_STORAGE
```

## package/qca/Config.in
```kconfig
config BR2_PACKAGE_QCA_SSDK
	bool "ssdk"
	depends on BR2_qca && QCA956X
	default y
	help
	  For qca hnat feature.

config BR2_PACKAGE_SSDK_SHELL
	bool "ssdk shell"
	depends on BR2_PACKAGE_QCA_SSDK
	default y
	help
	  Userspace utility to deal with qca ssdk.
```

## package/quagga/Config.in
```kconfig
config BR2_PACKAGE_QUAGGA
	bool "quagga"
	help
	  Routing software suite, providing implementations of
	  OSPFv2, OSPFv3 (IPv6), RIP v1 and v2, RIPng (IPv6) and BGPv4+.

	  http://www.quagga.net/

if BR2_PACKAGE_QUAGGA

	config BR2_QUAGGA_VERSION
		string "branch (1.1.1 if empty)"

	config BR2_QUAGGA_USER
		string "Username for quagga software launches"
		default "quagga"

	config BR2_PACKAGE_QUAGGA_ZEBRA
		bool
		default y
		help
		  Build zebra daemon.

	config BR2_PACKAGE_QUAGGA_RIPD
		bool "RIPv2/v3 protocol"
		help
		  Build ripd daemon.

	config BR2_PACKAGE_QUAGGA_RIPNGD
		bool "RIPng (IPv6) protocol"
		depends on BR2_INET_IPV6
		help
		  Build ripngd daemon.

	config BR2_PACKAGE_QUAGGA_OSPFD
		bool "OSPF protocol"
		default n
		help
		  Build ospfd daemon.

	config BR2_PACKAGE_QUAGGA_OSPF6D
		bool "OSPF6 protocol"
		depends on BR2_INET_IPV6
		default n
		help
		  Build ospf6d daemon.

	config BR2_PACKAGE_QUAGGA_LDPD
		bool "LDP protocol"
		default n
		help
		  Build ldpd daemon.
	if BR2_PACKAGE_QUAGGA_LDPD
		config BR2_PACKAGE_QUAGGA_LDPD_MPLS_IP_ENCAP_TABLE
			int "Route table to store MPLS-encap IP routes"
			default 13
			range 1 251
			help
			  This table will be used to store routes like
			    9.9.9.9  encap mpls  1001 via 10.90.8.100 dev eth3 proto zebra
			  which is used for data transporting. Whereas we should preserve
			  OSPF "clean L3" routes like
			    9.9.9.9 via 10.90.8.100 dev eth3 proto zebra metric 11
			  in the RT_TABLE_MAIN to use it for tLDP (direct connect w/o
			  any MPLS transport).

		config BR2_PACKAGE_QUAGGA_LDPD_NFMARK_BIT
			int "Bit in nfmark to tag output LDP frames"
			default 13
			range 0 31
			help
			  This bit should be set in nfmark of outgoiung LDP frames
			  by onboard management software. It is necessary to help
			  the frames bypass MPLS encap IP routes.
			  LDP is a serivice protocol and should communicate via L3 only.
	endif # BR2_PACKAGE_QUAGGA_LDPD

	config BR2_PACKAGE_QUAGGA_BGPD
		bool "BGPv4 protocol"
		help
		  Build bgpd daemon.

	config BR2_PACKAGE_QUAGGA_ISISD
		bool "IS-IS protocol"
		default n
		help
		  Build isisd daemon.
endif
```

## package/radvd/Config.in
```kconfig
config BR2_PACKAGE_RADVD
	bool "radvd"
	default n
	help
		The Router Advertisement Daemon (radvd) is an open-source software product that implements link-local advertisements of IPv6 router addresses and IPv6 routing prefixes (RFC 2461).
	  
		http://www.litech.org/radvd/
```

## package/remserial/Config.in
```kconfig
config BR2_PACKAGE_REMSERIAL
	bool "remserial"
	help
		The remserial program acts as a communications bridge between a
		TCP/IP network port and a Linux device such as a serial port.
		Any character-oriented Linux /dev device will work.
		http://lpccomp.bc.ca/remserial/
```

## package/samba/Config.in
```kconfig
config BR2_PACKAGE_SAMBA
	bool "Samba"
	select BR2_PACKAGE_UTIL_LINUX
	select BR2_PACKAGE_UTIL_LINUX_LIBUUID
	default n

config BR2_PACKAGE_SAMBA_FASTPATH
	depends on BR2_PACKAGE_SAMBA
	bool "Enable fastpath for samba"
	default n
```

## package/spim/Config.in
```kconfig
menuconfig BR2_PACKAGE_SPIM
	bool "spim"
	default n
	select BR2_LEGACY
	help
		MIPS emulator from http://spimsimulator.sourceforge.net/
		You definitely do not need this.


if BR2_PACKAGE_SPIM


config BR2_PACKAGE_SPIM_BRANCH
	string "spim branch (default if empty)"
	default "master"


endif
```

## package/sslsplit/Config.in
```kconfig
config BR2_PACKAGE_SSLSPLIT
	bool "sslsplit"
	select BR2_PACKAGE_LIBEVENT
	select BR2_PACKAGE_OPENSSL
```

## package/ssmtp/Config.in
```kconfig
config BR2_PACKAGE_SSMTP
	bool "ssmtp"
	help
	  

	  http://ftp.debian.org/debian/pool/main/s/ssmtp
```

## package/stockfish/Config.in
```kconfig
menuconfig BR2_PACKAGE_STOCKFISH
	bool "Stockfish-8"
	select BR2_LEGACY
	default n
	help
		Powerful chess engine.


if BR2_PACKAGE_STOCKFISH


config BR2_PACKAGE_STOCKFISH_BRANCH
	string "Stockfish branch (master if empty)"
	default "master"


endif
```

## package/tcpdump/Config.in
```kconfig
config BR2_PACKAGE_TCPDUMP
	bool "tcpdump"
	select BR2_PACKAGE_LIBPCAP
	help
	  A tool for network monitoring and data acquisition.

	  http://www.tcpdump.org/

if BR2_PACKAGE_TCPDUMP

config BR2_PACKAGE_TCPDUMP_SMB
	bool "smb dump support"
	help
	  enable possibly-buggy SMB printer

config BR2_PACKAGE_TCPDUMP_NONPRIVILEGED
	bool "allow running tcpdump from non-root users"
	default n
	help
	  allow running tcpdump from non-root users

endif
```
