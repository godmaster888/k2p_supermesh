## toolchain/gdb/Config.in
```kconfig
comment "Gdb Options"

config BR2_PACKAGE_GDB
	bool "Build full gdb for the Target"
	help
	    Build the gdbserver stub to run on the target.
	    A full gdb is needed to debug the progam.

config BR2_PACKAGE_GDB_SERVER
	bool "Build gdb server for the Target"
	help
	    Build the gdbserver stub to run on the target.
	    A full gdb is needed to debug the progam.

config BR2_PACKAGE_GDB_HOST
	bool "Build gdb for the Host"
	# cross-gdb is supposed to be part of the external
	# toolchain. And the build currently fails.
	help
	    Build gdb to run on the host to debug programs run on the target.

choice
	prompt "GDB debugger Version"
	default BR2_GDB_VERSION_6_8
	depends on BR2_PACKAGE_GDB || BR2_PACKAGE_GDB_SERVER || BR2_PACKAGE_GDB_HOST
	help
	  Select the version of gdb you wish to use.

	config BR2_GDB_VERSION_6_8
		bool "gdb 6.8"

	config BR2_GDB_VERSION_7_0_1
		bool "gdb 7.0.1"
		depends on !BR2_bfin
		depends on BR2_DEPRECATED
		depends on BR2_TOOLCHAIN_HAS_THREADS_DEBUG_IF_NEEDED
		select BR2_PTHREAD_DEBUG if (BR2_TOOLCHAIN_BUILDROOT && !BR2_PTHREADS_NONE)

	config BR2_GDB_VERSION_7_1
		bool "gdb 7.1"
		depends on !BR2_bfin
		depends on BR2_DEPRECATED
		depends on BR2_TOOLCHAIN_HAS_THREADS_DEBUG_IF_NEEDED
		select BR2_PTHREAD_DEBUG if (BR2_TOOLCHAIN_BUILDROOT && !BR2_PTHREADS_NONE)

	config BR2_GDB_VERSION_7_2
		bool "gdb 7.2.x"
		depends on !BR2_bfin
		depends on BR2_TOOLCHAIN_HAS_THREADS_DEBUG_IF_NEEDED
		select BR2_PTHREAD_DEBUG if (BR2_TOOLCHAIN_BUILDROOT && !BR2_PTHREADS_NONE)

	config BR2_GDB_VERSION_7_3
		bool "gdb 7.3.x"
		depends on !BR2_bfin
		depends on BR2_TOOLCHAIN_HAS_THREADS_DEBUG_IF_NEEDED
		select BR2_PTHREAD_DEBUG if (BR2_TOOLCHAIN_BUILDROOT && !BR2_PTHREADS_NONE)

	config BR2_GDB_VERSION_7_4
		bool "gdb 7.4.x"
		depends on !BR2_bfin
		depends on BR2_TOOLCHAIN_HAS_THREADS_DEBUG_IF_NEEDED
		select BR2_PTHREAD_DEBUG if (BR2_TOOLCHAIN_BUILDROOT && !BR2_PTHREADS_NONE)

	config BR2_GDB_VERSION_8_0
		bool "gdb 8.0"
		depends on !BR2_bfin
		depends on BR2_TOOLCHAIN_HAS_THREADS_DEBUG_IF_NEEDED
		select BR2_PTHREAD_DEBUG if (BR2_TOOLCHAIN_BUILDROOT && !BR2_PTHREADS_NONE)

endchoice

comment "gdb 7.x support needs pthread debug support in toolchain"
	depends on BR2_PACKAGE_GDB || BR2_PACKAGE_GDB_SERVER || BR2_PACKAGE_GDB_HOST
	depends on !BR2_TOOLCHAIN_HAS_THREADS_DEBUG_IF_NEEDED

config BR2_GDB_VERSION
	string
	default "6.8a"     if BR2_GDB_VERSION_6_8
	default "7.0.1a"   if BR2_GDB_VERSION_7_0_1
	default "7.1a"     if BR2_GDB_VERSION_7_1
	default "7.2a"     if BR2_GDB_VERSION_7_2
	default "7.3.1"    if BR2_GDB_VERSION_7_3
	default "7.4.1"    if BR2_GDB_VERSION_7_4
	default "8.0"      if BR2_GDB_VERSION_8_0
```

## vendor/Config.in
```kconfig
menu "Vendor options"
source "vendor/dlink/Config.in"

if BR2_ralink
source "vendor/ralink/Config.in"
endif

if BR2_qca
source "vendor/qca/Config.in"
endif

if (BR2_rlx && !BR2_modems) || BR2_rlx_9607 || BR2_rtk_luna
source "vendor/realtek/Config.in"
endif

endmenu
```

## vendor/dlink/Config.in
```kconfig
menu "Dlink"

source "vendor/dlink/device_type/Config.in"
source "vendor/dlink/device_info/Config.in"
source "vendor/dlink/customization/Config.in"
source "vendor/dlink/firmware/Config.in"
source "vendor/dlink/device_modes/Config.in"
source "vendor/dlink/auth/Config.in"
source "vendor/dlink/languages/Config.in"
source "vendor/dlink/features/Config.in"
source "vendor/dlink/factory/Config.in"
source "vendor/dlink/workaround/Config.in"

endmenu
```
