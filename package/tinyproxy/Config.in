## package/tinysvcmdns/Config.in
```kconfig
config BR2_PACKAGE_TINYSVCMDNS
	bool "tinysvcmdns"
	depends on !BR2_PACKAGE_MDNSRESPONDER
```

## package/transmission/Config.in
```kconfig
config BR2_PACKAGE_TRANSMISSION
	bool "transmission"
	depends on BR2_USE_MMU # fork()
	select BR2_PACKAGE_ZLIB
	select BR2_PACKAGE_OPENSSL
	select BR2_PACKAGE_LIBCURL
	select BR2_PACKAGE_LIBEVENT
	help
		Transmission is a cross-platform BitTorrent client.
		http://www.transmissionbt.com/

if BR2_PACKAGE_TRANSMISSION
config BR2_TRANSMISSION_CACHE_SIZE
	int "Default cache size (KB)"
	default 512
endif
```

## package/twamp-protocol/Config.in
```kconfig
menuconfig BR2_PACKAGE_TWAMP_PROTOCOL
	bool "twamp-protocol"

if BR2_PACKAGE_TWAMP_PROTOCOL

config BR2_SUPPORT_TWAMP_CLIENT
	bool "twamp-client"

config BR2_SUPPORT_TWAMP_SERVER
	bool "twamp-server"

endif
```

## package/udhcp/Config.in
```kconfig
menuconfig BR2_PACKAGE_UDHCP
	bool "udhcp"
	help
		Tiny dhcp client

if BR2_PACKAGE_UDHCP
	menuconfig UDHCP_RESTART_MIN_MAX_DELAY
	bool "Restart dhcp client for connect with min/max delay"
	default n
	help
		Min/max delay: if connection count more then MAX_RETRY: use max delay, else min delay.

	if UDHCP_RESTART_MIN_MAX_DELAY
		config BR2_UDHCP_MAX_RETRY
			string "Max count of dhcp client restart retry"
			default "1"
			help
				Max count of dhcp client restart retry

		config BR2_UDHCP_MAX_DELAY
			string "Max delay for restart dhcp client"
			default "30"
			help
				Max delay for restart dhcp client (sec)

		config BR2_UDHCP_MIN_DELAY
			string "Min delay for restart dhcp client"
			default "5"
			help
				Min delay for restart dhcp client (sec)
	endif

endif
```

## package/udpxy/Config.in
```kconfig
menuconfig BR2_PACKAGE_UDPXY
	bool "udpxy"

if BR2_PACKAGE_UDPXY
	config BR2_UDPXY_KERNEL_MULTICAST
	bool "HW multicast table in kernel"
	default y
	depends on RLX_819X
	help
		Set multicast group address to hw kernel multicast table
endif
```

## package/vlan/Config.in
```kconfig
config BR2_PACKAGE_VLAN
       bool "vlan"
       select BR2_LEGACY
       help
         vlan 8021q support
```

## package/vrrpd/Config.in
```kconfig
config BR2_PACKAGE_VRRPD
	bool "vrrpd"
	help
	  Аn implementation of Virtual Router Redundancy Protocol as specified in rfc2338.

	  https://github.com/fredbcode/Vrrpd
```

## package/wide_dhcpv6/Config.in
```kconfig
config BR2_PACKAGE_WIDE_DHCPV6
	bool "WIDE-DHCPv6"
	default n
	help
		WIDE-DHCPv6 is an open-source implementation of Dynamic Host Configuration Protocol for IPv6 (DHCPv6) originally developed by the KAME project.

		http://sourceforge.net/projects/wide-dhcpv6/
```

## package/wireless-regdb/Config.in
```kconfig
config BR2_PACKAGE_WIRELESS_REGDB
	bool "wireless-regdb"
	default n
	help
	  Wireless regulatory database.

	  Wireless regulatory database for CRDA. The database lists the
	  allowed radio frequencies for each local jurisdiction.

	  http://linuxwireless.org/en/developers/Regulatory


config BR2_PACKAGE_WIRELESS_REGDB_INSTALL_CERT
	bool "Install database signing certificate"
	depends on BR2_PACKAGE_WIRELESS_REGDB
	default n
	help
	  Enable this for install OpenSSL certificate to target filesystem when
	  installing database. Selecting N will disable the database validation.
```

## package/wpa_supplicant/Config.in
```kconfig
menuconfig BR2_PACKAGE_WPA_SUPPLICANT
	bool "wpa_supplicant"
	depends on BR2_SUPPORT_WIFI
	select BR2_PACKAGE_OPENSSL

if BR2_PACKAGE_WPA_SUPPLICANT

config BR2_WPA_SUPPLICANT_VERSION
	string "Wpa_supplicant branch (default branch if empty)"

endif
```

## package/xl2tp/Config.in
```kconfig
menuconfig BR2_PACKAGE_XL2TP
	bool "xl2tp"
	select BR2_PACKAGE_PPPD_L2TP if RLX_819X=n
	help
		Layer 2 Tunnelling Protocol (RFC2661).
		xl2tpd is an open source implementation of the L2TP tunneling
		protocol. xl2tpd is forked from l2tpd and is maintained by
		Xelerance Corporation.

		http://www.xelerance.com/software/xl2tpd/

if BR2_PACKAGE_XL2TP

config BR2_PACKAGE_XL2TP_VERSION
	string "xl2tp version"
	default "1.3.7"
	help
		L2TPD version

config BR2_PACKAGE_XL2TP_KERNEL_SUPPORT
	bool "Kernel support"
	default y if !RLX_819X
	help
	  Build daemon with enabled L2TP kernel support

config BR2_PACKAGE_XL2TP_CTRL
	bool "xl2tpd-control"
	default y

config BR2_PACKAGE_XL2TP_PFC
	bool "pfc"
	default n

config BR2_PACKAGE_XL2TP_AS_PTY
	bool "pty functionality"
	default n
	help
		for use xl2tpd as pty for pppd (need for l2tp on-demand)

endif
```

## package/xsupplicant/Config.in
```kconfig
menuconfig BR2_PACKAGE_XSUPPLICANT
	bool "xsupplicant"
	select BR2_LEGACY

if BR2_PACKAGE_XSUPPLICANT

config BR2_XSUPPLICANT_VERSION
	string "Xsupplicant branch (default branch if empty)"

endif
```

## package/yasslews/Config.in
```kconfig
#YASSLEWS HTTPS
config BR2_PACKAGE_YASSLEWS
	bool "yasslEWS"
	depends on !BR2_PACKAGE_CIVETWEB
	select BR2_LEGACY
	default n
	help
		The yaSSL Embedded Web Server is a fast, embeddable, and
		easy-to-configure web server with a strong focus on
		portability and security. It offers SSL/TLS (HTTPS) support
		built-in through the CyaSSL embedded SSL Library to provide
		you with the secure performance that your project needs.
		http://www.yassl.com

if BR2_PACKAGE_YASSLEWS

	source "package/libcyassl/Config.in"

config BR2_YASSLEWS_USE_AXTLS
	bool "axtls (enables HTTPS)"
	depends on BR2_PACKAGE_AXTLS

config BR2_YASSLEWS_EXTENDED_BUFFER
	bool "Extended buffer for yasslews"
	default y

endif	# BR2_PACKAGE_YASSLEWS
```

## package/zebra/Config.in
```kconfig
config BR2_PACKAGE_ZEBRA
	bool "zebra"
	help
	  Routing software suite, providing implementations of
	  OSPFv2, OSPFv3 (IPv6), RIP v1 and v2, RIPng (IPv6) and BGPv4+.

if BR2_PACKAGE_ZEBRA

config BR2_PACKAGE_ZEBRA_ZEBRA
	bool "zebra daemon"
	help
	  Build zebra daemon.

config BR2_PACKAGE_ZEBRA_BGPD
	bool "BPGv4+ protocol"
	help
	  Build bpgd daemon.

config BR2_PACKAGE_ZEBRA_OSPFD
	bool "OSPFv2 protocol"
	help
	  Build ospfd daemon.

config BR2_PACKAGE_ZEBRA_OSPF6D
	bool "OSPFv3 (IPv6) protocol"
	depends on BR2_INET_IPV6
	help
	  Build ospf6d daemon.

config BR2_PACKAGE_ZEBRA_RIPD
	bool "RIPv2/v3 protocol"
	help
	  Build ripd daemon.

config BR2_PACKAGE_ZEBRA_RIPNGD
	bool "RIPng (IPv6) protocol"
	depends on BR2_INET_IPV6
	help
	  Build ripngd daemon.

endif
```

## system/Config.in
```kconfig
menu "System configuration"

choice
	prompt "/dev management"
	default BR2_ROOTFS_DEVICE_CREATION_DYNAMIC_DEVTMPFS

config BR2_ROOTFS_DEVICE_CREATION_STATIC
	bool "Static using device table"

config BR2_ROOTFS_DEVICE_CREATION_DYNAMIC_DEVTMPFS
	bool "Dynamic using devtmpfs only"
	depends on BR2_DEUTERON_APPS_INIT_WITH_DEVTMPFS

endchoice

config BR2_ROOTFS_DEVICE_TABLE
	string "Path to the permission tables"
	default "system/device_table.txt"
	help
	  Specify a space-separated list of permission table locations,
	  that will be passed to the makedevs utility to assign
	  correct owners and permissions on various files in the
	  target filesystem.

	  See package/makedevs/README for details on the usage and
	  syntax of these files.

config BR2_ROOTFS_STATIC_DEVICE_TABLE
	string "Path to the device tables"
	default "system/device_table_dev.txt"
	depends on BR2_ROOTFS_DEVICE_CREATION_STATIC
	help
	  Specify a space-separated list of device table locations,
	  that will be passed to the makedevs utility to create all
	  the special device files under /dev.

	  See package/makedevs/README for details on the usage and
	  syntax of these files.

config BR2_ROOTFS_POST_BUILD_SCRIPT
	string "Custom scripts to run before creating filesystem images"
	default ""
	help
	  Specify a space-separated list of scripts to be run after the
	  build has finished and before Buildroot starts packing the
	  files into selected filesystem images.

	  This gives users the opportunity to do board-specific
	  cleanups, add-ons and the like, so the generated files can be
	  used directly without further processing.

	  These scripts are called with the target directory name as
	  first argument. Make sure the exit code of those scripts are
	  0, otherwise make will stop after calling them.

if BR2_ROOTFS_DEVICE_CREATION_STATIC
menu "device table tune"

config BR2_DEVICE_TABLE_MTD_COUNT
	int "mtd device count"
	default 8
	range 1 24

endmenu
endif

config BR2_SYSTEM_DEFAULT_PATH
	string "Set the system's default PATH"
	default "/bin:/sbin:/usr/bin:/usr/sbin"
	help
	  Sets the system's default PATH. It is being used in
	  /etc/profile in the skeleton-init-common package and by some
	  daemons.

	  The default should work in most cases.

config BR2_PARTS_FILE
	string "firmware parts file"
	default ""

endmenu
```

## target/Config.in
```kconfig
config BR2_ENDIAN
	string
	default "LITTLE"   if mipsel || mips64el || i386 || x86_64 || arm
	default "BIG"      if mips   || mips64 || armeb

config mips
	bool
config mipsel
	bool
config mips64
	bool
config mips64el
	bool
config i386
	bool
config x86_64
	bool
config arm
	bool

config TARGET_ARCH
	string
	default "arm"     if arm
	default "armeb"   if armeb
	default "mips"    if mips
	default "mipsel"  if mipsel
	default "mips64"    if mips64
	default "mips64el"  if mips64el
	default "i386"    if i386
	default "x86_64"    if x86_64

menu "Target Options"
choice
	prompt "Target"
	default BR2_ar7240
	help
	  Select the target architecture family to build for.
config BR2_ar7240
	bool "AR7240"
config BR2_qca
	bool "Qualcomm"
config BR2_ralink
	bool "Ralink"

config BR2_rlx
	bool "Realtek"

config BR2_rlx_9607
	bool "Realtek RG/Apollo"
	select mips

config BR2_i386
	bool "X86/Virtual"
	select i386

config BR2_x86_64
	bool "X86/64"
	select x86_64

config BR2_rtk_ms
	bool "Realtek MSwitch"

config BR2_rtk_luna
	bool "Realtek Luna"

config BR2_bcm
	bool "Broadcom"

endchoice

if BR2_ar7240
source target/ar7240/Config.in
endif

if BR2_qca
source target/qca/Config.in
endif

if BR2_ralink
source target/ralink/Config.in
endif

if BR2_rlx
source target/rlx/Config.in
endif

if BR2_bcm
source target/bcm/Config.in
endif

if BR2_rtk_ms
source target/rtk_ms/Config.in
endif

if BR2_rtk_luna
source target/rtk_luna/Config.in
endif

if BR2_i386 || BR2_x86_64
source target/x86/Config.in
endif

endmenu
```

## target/ralink/Config.in
```kconfig
config RALINK_MTK_SUPPORTS_PCI
	bool
	default n

choice
	prompt "Target Variant"
config RALINK_RT6855
	bool "RT6855"
	select mipsel
config RALINK_RT6855A
	bool "RT6855A"
	select mipsel
config RALINK_MT7620
	bool "MT7620"
	select mipsel
	# see N|A variants below
config RALINK_MT7621
	bool "MT7621"
	select mipsel
	select RALINK_MTK_SUPPORTS_PCI
config RALINK_MT7628
	bool "MT7628"
	select mipsel
	select RALINK_MTK_SUPPORTS_PCI
endchoice

choice
	prompt "MT7620 Variant"
	depends on RALINK_MT7620
	default RALINK_MT7620A
config RALINK_MT7620N
	bool "MT7620N"
	# see Wi-Fi variants below
config RALINK_MT7620A
	bool "MT7620A"
	select RALINK_MTK_SUPPORTS_PCI
endchoice

choice
	prompt "MT7620N Wi-Fi Variant"
	depends on RALINK_MT7620N
	depends on BR2_SUPPORT_WIFI
	default RALINK_MT7620N_NEW_WIFI
config RALINK_MT7620N_NEW_WIFI
	bool "MT7620N with new Wi-Fi (rlt_wifi)"
endchoice
```

## toolchain/Config.in
```kconfig
menu "Toolchain"
choice
	prompt "Toolchain type"
	help
		Select whether to use the toolchain provided by buildroot
		or an external toolchain.

		Some vendors provide toolchains in binary form, some in
		source form.

config BR2_TOOLCHAIN_EXTERNAL
	bool "External toolchain"
endchoice

#18758
choice
	prompt "Libc type"
	default BR2_TOOLCHAIN_USES_UCLIBC

config BR2_TOOLCHAIN_USES_GLIBC
	bool "glibc"
	select BR2_USE_WCHAR
	select BR2_TOOLCHAIN_HAS_THREADS
	select BR2_TOOLCHAIN_HAS_THREADS_NPTL
	select BR2_TOOLCHAIN_HAS_THREADS_DEBUG
	#depends on BR2_TOOLCHAIN_EXTERNAL ???

config BR2_TOOLCHAIN_USES_UCLIBC
	bool "uClibc"
	#depends on BR2_TOOLCHAIN_EXTERNAL ???

config BR2_TOOLCHAIN_USES_MUSL
	bool "musl"
	select BR2_USE_WCHAR
	select BR2_TOOLCHAIN_HAS_THREADS
	select BR2_TOOLCHAIN_HAS_THREADS_NPTL
	select BR2_TOOLCHAIN_HAS_THREADS_DEBUG
	#depends on BR2_TOOLCHAIN_EXTERNAL ???
	help
		Set to y if this toolchain is built
		with musl libc: https://www.musl-libc.org/
endchoice

config BR2_TOOLCHAIN_EXTERNAL_VERSION
	string "Toolchain branch (master if empty)"
	depends on BR2_TOOLCHAIN_EXTERNAL

config BR2_TOOLCHAIN_EXTERNAL_LOCATION
	string "URL of toolchains tarball"
	depends on BR2_TOOLCHAIN_EXTERNAL

config BR2_USRINC_PATH
	string "Path to usr/include"
	depends on BR2_TOOLCHAIN_EXTERNAL

config BR2_LIB_PATH
	string "Path to libs in /lib"
	depends on BR2_TOOLCHAIN_EXTERNAL

config BR2_USRLIB_PATH
	string "Path to libs in /usr/lib"
	depends on BR2_TOOLCHAIN_EXTERNAL

config BR2_USRBIN_HACK
	bool "Use usr/bin instead of bin in toolchain path"

config BR2_SYSROOT
	bool "Add --sysroot=STAGING_DIR option to gcc "

config BR2_TOOLCHAIN_EXTERNAL_PATH
	string "External toolchain path to sysroot"
	help
		Path to where the external toolchain is installed.
		mips-dlink-linux-uclibc/sys-root

config BR2_TOOLCHAIN_EXTERNAL_PREFIX
	string "External toolchain prefix"
	default "$(ARCH)-linux"
	help
		This the the external toolchain prefix. For example:
		armeb-unknown-linux-gnu, mipsel-unknown-linux-gnu, etc.

config BR2_USE_WCHAR
	bool "Toolchain has wchar support"

config BR2_ENABLE_LOCALE
	bool "Toolchain has locale support"

config BR2_INSTALL_LIBSTDCPP
	bool "Toolchain has C++ support"

config BR2_TOOLCHAIN_HAS_THREADS
	bool "Toolchain has threads"

config BR2_TOOLCHAIN_HAS_THREADS_NPTL
	bool "Toolchain has NPTL threads"
	depends on BR2_TOOLCHAIN_HAS_THREADS

config BR2_TOOLCHAIN_HAS_THREADS_DEBUG
	bool "Toolchain has debugging threads"
	select BR2_TOOLCHAIN_HAS_THREADS_DEBUG_IF_NEEDED
	bool

config BR2_TOOLCHAIN_HAS_THREADS_DEBUG_IF_NEEDED
	default y if !BR2_TOOLCHAIN_HAS_THREADS
	bool

config BR2_TOOLCHAIN_EXTRA_LIBS
	string "Extra toolchain libraries to be copied to target"
	depends on !BR2_STATIC_LIBS
	help
	  If your toolchain provides extra libraries that need to be
	  copied to the target filesystem, enter them here, separated
	  by spaces. The library should not include a suffix or any
	  type of pre/post wildcard.

	  Examples where this can be useful is for adding debug
	  libraries to the target like the GCC libsanitizer.
	  e.g. "libasan liblsan libtsan libubsan"

config BR2_USE_MMU
	bool "Enable MMU support"
	default y
	help
		If your target has a MMU, you should say Y here.  If you
		are unsure, just say Y.

  config BR2_LARGEFILE
	  bool "Enable large file (files > 2 GB) support?"
	  default y
	  help
		  If you are building your own toolchain and you want to
		  support files larger than 2GB then enable this option.
		  If you have an external binary toolchain that has been
		  built with large file support (files > 2GB) then enable
		  this option.

source "toolchain/gdb/Config.in"

endmenu
```
